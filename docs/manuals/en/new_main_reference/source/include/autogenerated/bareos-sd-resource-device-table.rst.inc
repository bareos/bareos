.. csv-table::
   :header: "configuration directive name", "type of data", "default value", "remark"

   :config:option:`sd/device/AlertCommand`\                    , "= STRNAME", "", ""
   :config:option:`sd/device/AlwaysOpen`\                      , "= BIT", "yes", ""
   :config:option:`sd/device/ArchiveDevice`\                   , "**= STRNAME** ", "", "**required** "
   :config:option:`sd/device/AutoDeflate`\                     , "= IO_DIRECTION", "", ""
   :config:option:`sd/device/AutoDeflateAlgorithm`\            , "= COMPRESSION_ALGORITHM", "", ""
   :config:option:`sd/device/AutoDeflateLevel`\                , "= PINT16", "6", ""
   :config:option:`sd/device/AutoInflate`\                     , "= IO_DIRECTION", "", ""
   :config:option:`sd/device/AutoSelect`\                      , "= BOOLEAN", "yes", ""
   :config:option:`sd/device/Autochanger`\                     , "= BIT", "no", ""
   :config:option:`sd/device/AutomaticMount`\                  , "= BIT", "no", ""
   :config:option:`sd/device/BackwardSpaceFile`\               , "= BIT", "yes", ""
   :config:option:`sd/device/BackwardSpaceRecord`\             , "= BIT", "yes", ""
   :config:option:`sd/device/BlockChecksum`\                   , "= BIT", "yes", ""
   :config:option:`sd/device/BlockPositioning`\                , "= BIT", "yes", ""
   :config:option:`sd/device/BsfAtEom`\                        , "= BIT", "no", ""
   :config:option:`sd/device/ChangerCommand`\                  , "= STRNAME", "", ""
   :config:option:`sd/device/ChangerDevice`\                   , "= STRNAME", "", ""
   :config:option:`sd/device/CheckLabels`\                     , "= BIT", "no", ""
   :config:option:`sd/device/CloseOnPoll`\                     , "= BIT", "no", ""
   :config:option:`sd/device/CollectStatistics`\               , "= BOOLEAN", "yes", ""
   :config:option:`sd/device/Description`\                     , "= STRING", "", ""
   :config:option:`sd/device/DeviceOptions`\                   , "= STRING", "", ""
   :config:option:`sd/device/DeviceType`\                      , "= DEVICE_TYPE", "", ""
   :config:option:`sd/device/DiagnosticDevice`\                , "= STRNAME", "", ""
   :config:option:`sd/device/DriveCryptoEnabled`\              , "= BOOLEAN", "", ""
   :config:option:`sd/device/DriveIndex`\                      , "= PINT16", "", ""
   :config:option:`sd/device/DriveTapeAlertEnabled`\           , "= BOOLEAN", "", ""
   :config:option:`sd/device/EofOnErrorIsEot`\                 , "= BOOLEAN", "", ""
   :config:option:`sd/device/FastForwardSpaceFile`\            , "= BIT", "yes", ""
   :config:option:`sd/device/ForwardSpaceFile`\                , "= BIT", "yes", ""
   :config:option:`sd/device/ForwardSpaceRecord`\              , "= BIT", "yes", ""
   :config:option:`sd/device/FreeSpaceCommand`\                , "*= STRNAME* ", "", "*deprecated* "
   :config:option:`sd/device/HardwareEndOfFile`\               , "= BIT", "yes", ""
   :config:option:`sd/device/HardwareEndOfMedium`\             , "= BIT", "yes", ""
   :config:option:`sd/device/LabelBlockSize`\                  , "= PINT32", "64512", ""
   :config:option:`sd/device/LabelMedia`\                      , "= BIT", "no", ""
   :config:option:`sd/device/LabelType`\                       , "= LABEL", "", ""
   :config:option:`sd/device/MaximumBlockSize`\                , "= MAX_BLOCKSIZE", "", ""
   :config:option:`sd/device/MaximumChangerWait`\              , "= TIME", "300", ""
   :config:option:`sd/device/MaximumConcurrentJobs`\           , "= PINT32", "", ""
   :config:option:`sd/device/MaximumFileSize`\                 , "= SIZE64", "1000000000", ""
   :config:option:`sd/device/MaximumJobSpoolSize`\             , "= SIZE64", "", ""
   :config:option:`sd/device/MaximumNetworkBufferSize`\        , "= PINT32", "", ""
   :config:option:`sd/device/MaximumOpenVolumes`\              , "= PINT32", "1", ""
   :config:option:`sd/device/MaximumOpenWait`\                 , "= TIME", "300", ""
   :config:option:`sd/device/MaximumPartSize`\                 , "*= SIZE64* ", "", "*deprecated* "
   :config:option:`sd/device/MaximumRewindWait`\               , "= TIME", "300", ""
   :config:option:`sd/device/MaximumSpoolSize`\                , "= SIZE64", "", ""
   :config:option:`sd/device/MaximumVolumeSize`\               , "*= SIZE64* ", "", "*deprecated* "
   :config:option:`sd/device/MediaType`\                       , "**= STRNAME** ", "", "**required** "
   :config:option:`sd/device/MinimumBlockSize`\                , "= PINT32", "", ""
   :config:option:`sd/device/MountCommand`\                    , "= STRNAME", "", ""
   :config:option:`sd/device/MountPoint`\                      , "= STRNAME", "", ""
   :config:option:`sd/device/Name`\                            , "**= NAME** ", "", "**required** "
   :config:option:`sd/device/NoRewindOnClose`\                 , "= BOOLEAN", "yes", ""
   :config:option:`sd/device/OfflineOnUnmount`\                , "= BIT", "no", ""
   :config:option:`sd/device/QueryCryptoStatus`\               , "= BOOLEAN", "", ""
   :config:option:`sd/device/RandomAccess`\                    , "= BIT", "no", ""
   :config:option:`sd/device/RemovableMedia`\                  , "= BIT", "yes", ""
   :config:option:`sd/device/RequiresMount`\                   , "= BIT", "no", ""
   :config:option:`sd/device/SpoolDirectory`\                  , "= DIRECTORY", "", ""
   :config:option:`sd/device/TwoEof`\                          , "= BIT", "no", ""
   :config:option:`sd/device/UnmountCommand`\                  , "= STRNAME", "", ""
   :config:option:`sd/device/UseMtiocget`\                     , "= BIT", "yes", ""
   :config:option:`sd/device/VolumeCapacity`\                  , "= SIZE64", "", ""
   :config:option:`sd/device/VolumePollInterval`\              , "= TIME", "300", ""
   :config:option:`sd/device/WritePartCommand`\                , "*= STRNAME* ", "", "*deprecated* "

