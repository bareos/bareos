.. index::
   single: Platform; openSUSE; 13.1
   single: Platform; openSUSE; 13.2
   single: Platform; openSUSE; 15.0
   single: Platform; openSUSE; 42.1
   single: Platform; openSUSE; 42.2
   single: Platform; openSUSE; 42.3

.. csv-table::
   :header: "", "openSUSE 13.1", "openSUSE 13.2", "openSUSE 15.0", "openSUSE 42.1", "openSUSE 42.2", "openSUSE 42.3"

   bareos, 12.4-15.2, 13.2-16.2, 18.2, 15.2-16.2, 17.2, 17.2
   bareos-bat, 12.4-15.2, 13.2-16.2,  , 15.2-16.2,  ,  
   bareos-bconsole, 12.4-15.2, 13.2-16.2, 18.2, 15.2-16.2, 17.2, 17.2
   bareos-client, 12.4-15.2, 13.2-16.2, 18.2, 15.2-16.2, 17.2, 17.2
   bareos-common, 12.4-15.2, 13.2-16.2, 18.2, 15.2-16.2, 17.2, 17.2
   bareos-database-common, 12.4-15.2, 13.2-16.2, 18.2, 15.2-16.2, 17.2, 17.2
   bareos-database-mysql, 12.4-15.2, 13.2-16.2, 18.2, 15.2-16.2, 17.2, 17.2
   bareos-database-postgresql, 12.4-15.2, 13.2-16.2, 18.2, 15.2-16.2, 17.2, 17.2
   bareos-database-sqlite3, 12.4-15.2, 13.2-16.2, 18.2, 15.2-16.2, 17.2, 17.2
   bareos-database-tools, 12.4-15.2, 13.2-16.2, 18.2, 15.2-16.2, 17.2, 17.2
   bareos-director, 12.4-15.2, 13.2-16.2, 18.2, 15.2-16.2, 17.2, 17.2
   bareos-director-python-plugin, 14.2-15.2, 14.2-16.2, 18.2, 15.2-16.2, 17.2, 17.2
   bareos-filedaemon, 12.4-15.2, 13.2-16.2, 18.2, 15.2-16.2, 17.2, 17.2
   bareos-filedaemon-ceph-plugin,  ,  , 18.2,  ,  ,  
   bareos-filedaemon-ldap-python-plugin, 15.2, 15.2-16.2, 18.2, 15.2-16.2, 17.2, 17.2
   bareos-filedaemon-python-plugin, 14.2-15.2, 14.2-16.2, 18.2, 15.2-16.2, 17.2, 17.2
   bareos-regress-config,  ,  , 18.2,  , 17.2, 17.2
   bareos-storage, 12.4-15.2, 13.2-16.2, 18.2, 15.2-16.2, 17.2, 17.2
   bareos-storage-ceph,  ,  , 18.2,  ,  ,  
   bareos-storage-droplet,  ,  ,  ,  , 17.2, 17.2
   bareos-storage-fifo, 14.2-15.2, 14.2-16.2, 18.2, 15.2-16.2, 17.2, 17.2
   bareos-storage-python-plugin, 14.2-15.2, 14.2-16.2, 18.2, 15.2-16.2, 17.2, 17.2
   bareos-storage-tape, 12.4-15.2, 13.2-16.2, 18.2, 15.2-16.2, 17.2, 17.2
   bareos-tools, 12.4-15.2, 13.2-16.2, 18.2, 15.2-16.2, 17.2, 17.2
   bareos-traymonitor, 12.4-15.2, 13.2-16.2, 18.2, 15.2-16.2, 17.2, 17.2
   bareos-vadp-dumper,  ,  , 18.2,  ,  ,  
   bareos-vmware-plugin,  ,  , 18.2,  ,  ,  
   bareos-vmware-plugin-compat,  ,  , 18.2,  ,  ,  
   bareos-webui, 15.2, 15.2-16.2, 18.2, 15.2-16.2, 17.2, 17.2
   libdroplet,  ,  ,  ,  , 17.2, 17.2
   libfastlz, 12.4-15.2, 13.2-16.2, 18.2, 15.2-16.2, 17.2, 17.2
   python-bareos,  ,  , 18.2,  , 17.2, 17.2

