.. csv-table::
   :header: "configuration directive name", "type of data", "default value", "remark"

   :config:option:`console/storage/Address`\                   , "**= STRING** ", "", "**required** "
   :config:option:`console/storage/Description`\               , "= STRING", "", ""
   :config:option:`console/storage/Name`\                      , "**= NAME** ", "", "**required** "
   :config:option:`console/storage/Password`\                  , "**= MD5PASSWORD** ", "", "**required** "
   :config:option:`console/storage/SdAddress`\                 , "= STRING", "", ""
   :config:option:`console/storage/SdPassword`\                , "= MD5PASSWORD", "", ""
   :config:option:`console/storage/SdPort`\                    , "= PINT32", "9103", ""
   :config:option:`console/storage/TlsAllowedCn`\              , "= STRING_LIST", "", ""
   :config:option:`console/storage/TlsAuthenticate`\           , "= BOOLEAN", "no", ""
   :config:option:`console/storage/TlsCaCertificateDir`\       , "= DIRECTORY", "", ""
   :config:option:`console/storage/TlsCaCertificateFile`\      , "= DIRECTORY", "", ""
   :config:option:`console/storage/TlsCertificate`\            , "= DIRECTORY", "", ""
   :config:option:`console/storage/TlsCertificateRevocationList`\ , "= DIRECTORY", "", ""
   :config:option:`console/storage/TlsCipherList`\             , "= DIRECTORY", "", ""
   :config:option:`console/storage/TlsDhFile`\                 , "= DIRECTORY", "", ""
   :config:option:`console/storage/TlsEnable`\                 , "= BOOLEAN", "yes", ""
   :config:option:`console/storage/TlsKey`\                    , "= DIRECTORY", "", ""
   :config:option:`console/storage/TlsRequire`\                , "= BOOLEAN", "no", ""
   :config:option:`console/storage/TlsVerifyPeer`\             , "= BOOLEAN", "no", ""

