.. csv-table::
   :header: "configuration directive name", "type of data", "default value", "remark"

   :config:option:`dir/catalog/Address`\                       , "*= STRING* ", "", "*alias* "
   :config:option:`dir/catalog/DbAddress`\                     , "= STRING", "", ""
   :config:option:`dir/catalog/DbDriver`\                      , "**= STRING** ", "", "**required** "
   :config:option:`dir/catalog/DbName`\                        , "**= STRING** ", "", "**required** "
   :config:option:`dir/catalog/DbPassword`\                    , "= AUTOPASSWORD", "", ""
   :config:option:`dir/catalog/DbPort`\                        , "= PINT32", "", ""
   :config:option:`dir/catalog/DbSocket`\                      , "= STRING", "", ""
   :config:option:`dir/catalog/DbUser`\                        , "= STRING", "", ""
   :config:option:`dir/catalog/Description`\                   , "= STRING", "", ""
   :config:option:`dir/catalog/DisableBatchInsert`\            , "= BOOLEAN", "no", ""
   :config:option:`dir/catalog/ExitOnFatal`\                   , "= BOOLEAN", "no", ""
   :config:option:`dir/catalog/IdleTimeout`\                   , "= PINT32", "30", ""
   :config:option:`dir/catalog/IncConnections`\                , "= PINT32", "1", ""
   :config:option:`dir/catalog/MaxConnections`\                , "= PINT32", "5", ""
   :config:option:`dir/catalog/MinConnections`\                , "= PINT32", "1", ""
   :config:option:`dir/catalog/MultipleConnections`\           , "= BIT", "", ""
   :config:option:`dir/catalog/Name`\                          , "**= NAME** ", "", "**required** "
   :config:option:`dir/catalog/Password`\                      , "*= AUTOPASSWORD* ", "", "*alias* "
   :config:option:`dir/catalog/Reconnect`\                     , "= BOOLEAN", "no", ""
   :config:option:`dir/catalog/User`\                          , "*= STRING* ", "", "*alias* "
   :config:option:`dir/catalog/ValidateTimeout`\               , "= PINT32", "120", ""

