.. index::
   single: Platform; Fedora; 20
   single: Platform; Fedora; 21
   single: Platform; Fedora; 22
   single: Platform; Fedora; 23
   single: Platform; Fedora; 24
   single: Platform; Fedora; 25
   single: Platform; Fedora; 26
   single: Platform; Fedora; 27
   single: Platform; Fedora; 28
   single: Platform; Fedora; 29

.. csv-table::
   :header: "", "Fedora 20", "Fedora 21", "Fedora 22", "Fedora 23", "Fedora 24", "Fedora 25", "Fedora 26", "Fedora 27", "Fedora 28", "Fedora 29"

   bareos, 12.4-15.2, 14.2-15.2, 15.2, 15.2-16.2, 16.2, 17.2, 17.2,  , 18.2, 18.2
   bareos-bat, 12.4-15.2, 14.2-15.2, 15.2, 15.2-16.2, 16.2,  ,  ,  ,  ,  
   bareos-bconsole, 12.4-15.2, 14.2-15.2, 15.2, 15.2-16.2, 16.2, 17.2, 17.2,  , 18.2, 18.2
   bareos-client, 12.4-15.2, 14.2-15.2, 15.2, 15.2-16.2, 16.2, 17.2, 17.2,  , 18.2, 18.2
   bareos-common, 12.4-15.2, 14.2-15.2, 15.2, 15.2-16.2, 16.2, 17.2, 17.2,  , 18.2, 18.2
   bareos-database-common, 12.4-15.2, 14.2-15.2, 15.2, 15.2-16.2, 16.2, 17.2, 17.2,  , 18.2, 18.2
   bareos-database-mysql, 12.4-15.2, 14.2-15.2, 15.2, 15.2-16.2, 16.2, 17.2, 17.2,  , 18.2, 18.2
   bareos-database-postgresql, 12.4-15.2, 14.2-15.2, 15.2, 15.2-16.2, 16.2, 17.2, 17.2,  , 18.2, 18.2
   bareos-database-sqlite3, 12.4-15.2, 14.2-15.2, 15.2, 15.2-16.2, 16.2, 17.2, 17.2,  , 18.2, 18.2
   bareos-database-tools, 12.4-15.2, 14.2-15.2, 15.2, 15.2-16.2, 16.2, 17.2, 17.2,  , 18.2, 18.2
   bareos-director, 12.4-15.2, 14.2-15.2, 15.2, 15.2-16.2, 16.2, 17.2, 17.2,  , 18.2, 18.2
   bareos-director-python-plugin, 14.2-15.2, 14.2-15.2, 15.2, 15.2-16.2, 16.2, 17.2, 17.2,  , 18.2, 18.2
   bareos-filedaemon, 12.4-15.2, 14.2-15.2, 15.2, 15.2-16.2, 16.2, 17.2, 17.2,  , 18.2, 18.2
   bareos-filedaemon-glusterfs-plugin, 15.2, 15.2, 15.2, 15.2-16.2, 16.2, 17.2, 17.2,  , 18.2, 18.2
   bareos-filedaemon-ldap-python-plugin, 15.2, 15.2, 15.2, 15.2-16.2, 16.2, 17.2, 17.2,  , 18.2, 18.2
   bareos-filedaemon-python-plugin, 14.2-15.2, 14.2-15.2, 15.2, 15.2-16.2, 16.2, 17.2, 17.2,  , 18.2, 18.2
   bareos-regress-config,  ,  ,  ,  ,  , 17.2, 17.2,  , 18.2, 18.2
   bareos-storage, 12.4-15.2, 14.2-15.2, 15.2, 15.2-16.2, 16.2, 17.2, 17.2,  , 18.2, 18.2
   bareos-storage-fifo, 14.2-15.2, 14.2-15.2, 15.2, 15.2-16.2, 16.2, 17.2, 17.2,  , 18.2, 18.2
   bareos-storage-glusterfs, 14.2-15.2, 14.2-15.2, 15.2, 15.2-16.2, 16.2, 17.2, 17.2,  , 18.2, 18.2
   bareos-storage-python-plugin, 14.2-15.2, 14.2-15.2, 15.2, 15.2-16.2, 16.2, 17.2, 17.2,  , 18.2, 18.2
   bareos-storage-tape, 12.4-15.2, 14.2-15.2, 15.2, 15.2-16.2, 16.2, 17.2, 17.2,  , 18.2, 18.2
   bareos-tools, 12.4-15.2, 14.2-15.2, 15.2, 15.2-16.2, 16.2, 17.2, 17.2,  , 18.2, 18.2
   bareos-traymonitor, 12.4-15.2, 14.2-15.2, 15.2, 15.2-16.2, 16.2, 17.2, 17.2,  , 18.2, 18.2
   bareos-webui, 15.2, 15.2, 15.2, 15.2-16.2, 16.2, 17.2, 17.2,  , 18.2, 18.2
   libfastlz, 12.4-15.2, 14.2-15.2, 15.2, 15.2-16.2, 16.2, 17.2, 17.2, 17.2, 18.2, 18.2
   python-bareos,  ,  ,  ,  ,  , 17.2, 17.2, 17.2, 18.2, 18.2

