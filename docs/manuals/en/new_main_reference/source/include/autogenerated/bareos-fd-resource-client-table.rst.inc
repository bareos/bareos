.. csv-table::
   :header: "configuration directive name", "type of data", "default value", "remark"

   :config:option:`fd/client/AbsoluteJobTimeout`\              , "= PINT32", "", ""
   :config:option:`fd/client/AllowBandwidthBursting`\          , "= BOOLEAN", "no", ""
   :config:option:`fd/client/AllowedJobCommand`\               , "= STRING_LIST", "", ""
   :config:option:`fd/client/AllowedScriptDir`\                , "= DIRECTORY_LIST", "", ""
   :config:option:`fd/client/AlwaysUseLmdb`\                   , "= BOOLEAN", "no", ""
   :config:option:`fd/client/Compatible`\                      , "= BOOLEAN", "no", ""
   :config:option:`fd/client/Description`\                     , "= STRING", "", ""
   :config:option:`fd/client/FdAddress`\                       , "= ADDRESS", "9102", ""
   :config:option:`fd/client/FdAddresses`\                     , "= ADDRESSES", "9102", ""
   :config:option:`fd/client/FdPort`\                          , "= PORT", "9102", ""
   :config:option:`fd/client/FdSourceAddress`\                 , "= ADDRESS", "0", ""
   :config:option:`fd/client/HeartbeatInterval`\               , "= TIME", "0", ""
   :config:option:`fd/client/LmdbThreshold`\                   , "= PINT32", "", ""
   :config:option:`fd/client/LogTimestampFormat`\              , "= STRING", "", ""
   :config:option:`fd/client/MaximumBandwidthPerJob`\          , "= SPEED", "", ""
   :config:option:`fd/client/MaximumConcurrentJobs`\           , "= PINT32", "20", ""
   :config:option:`fd/client/MaximumConnections`\              , "= PINT32", "42", ""
   :config:option:`fd/client/MaximumNetworkBufferSize`\        , "= PINT32", "", ""
   :config:option:`fd/client/Messages`\                        , "= RES", "", ""
   :config:option:`fd/client/Name`\                            , "**= NAME** ", "", "**required** "
   :config:option:`fd/client/PidDirectory`\                    , "= DIRECTORY", "/var/lib/bareos *(platform specific)*", ""
   :config:option:`fd/client/PkiCipher`\                       , "= ENCRYPTION_CIPHER", "aes128", ""
   :config:option:`fd/client/PkiEncryption`\                   , "= BOOLEAN", "no", ""
   :config:option:`fd/client/PkiKeyPair`\                      , "= DIRECTORY", "", ""
   :config:option:`fd/client/PkiMasterKey`\                    , "= DIRECTORY_LIST", "", ""
   :config:option:`fd/client/PkiSignatures`\                   , "= BOOLEAN", "no", ""
   :config:option:`fd/client/PkiSigner`\                       , "= DIRECTORY_LIST", "", ""
   :config:option:`fd/client/PluginDirectory`\                 , "= DIRECTORY", "", ""
   :config:option:`fd/client/PluginNames`\                     , "= PLUGIN_NAMES", "", ""
   :config:option:`fd/client/ScriptsDirectory`\                , "= DIRECTORY", "", ""
   :config:option:`fd/client/SdConnectTimeout`\                , "= TIME", "1800", ""
   :config:option:`fd/client/SecureEraseCommand`\              , "= STRING", "", ""
   :config:option:`fd/client/SubSysDirectory`\                 , "*= DIRECTORY* ", "", "*deprecated* "
   :config:option:`fd/client/TlsAllowedCn`\                    , "= STRING_LIST", "", ""
   :config:option:`fd/client/TlsAuthenticate`\                 , "= BOOLEAN", "no", ""
   :config:option:`fd/client/TlsCaCertificateDir`\             , "= DIRECTORY", "", ""
   :config:option:`fd/client/TlsCaCertificateFile`\            , "= DIRECTORY", "", ""
   :config:option:`fd/client/TlsCertificate`\                  , "= DIRECTORY", "", ""
   :config:option:`fd/client/TlsCertificateRevocationList`\    , "= DIRECTORY", "", ""
   :config:option:`fd/client/TlsCipherList`\                   , "= DIRECTORY", "", ""
   :config:option:`fd/client/TlsDhFile`\                       , "= DIRECTORY", "", ""
   :config:option:`fd/client/TlsEnable`\                       , "= BOOLEAN", "yes", ""
   :config:option:`fd/client/TlsKey`\                          , "= DIRECTORY", "", ""
   :config:option:`fd/client/TlsRequire`\                      , "= BOOLEAN", "no", ""
   :config:option:`fd/client/TlsVerifyPeer`\                   , "= BOOLEAN", "no", ""
   :config:option:`fd/client/VerId`\                           , "= STRING", "", ""
   :config:option:`fd/client/WorkingDirectory`\                , "= DIRECTORY", "/var/lib/bareos *(platform specific)*", ""

