.. csv-table::
   :header: "configuration directive name", "type of data", "default value", "remark"

   :config:option:`dir/user/CatalogACL`\                       , "= ACL", "", ""
   :config:option:`dir/user/ClientACL`\                        , "= ACL", "", ""
   :config:option:`dir/user/CommandACL`\                       , "= ACL", "", ""
   :config:option:`dir/user/Description`\                      , "= STRING", "", ""
   :config:option:`dir/user/FileSetACL`\                       , "= ACL", "", ""
   :config:option:`dir/user/JobACL`\                           , "= ACL", "", ""
   :config:option:`dir/user/Name`\                             , "**= NAME** ", "", "**required** "
   :config:option:`dir/user/Password`\                         , "**= AUTOPASSWORD** ", "", "**required** "
   :config:option:`dir/user/PluginOptionsACL`\                 , "= ACL", "", ""
   :config:option:`dir/user/PoolACL`\                          , "= ACL", "", ""
   :config:option:`dir/user/Profile`\                          , "= RESOURCE_LIST", "", ""
   :config:option:`dir/user/RunACL`\                           , "= ACL", "", ""
   :config:option:`dir/user/ScheduleACL`\                      , "= ACL", "", ""
   :config:option:`dir/user/StorageACL`\                       , "= ACL", "", ""
   :config:option:`dir/user/TlsAllowedCn`\                     , "= STRING_LIST", "", ""
   :config:option:`dir/user/TlsAuthenticate`\                  , "= BOOLEAN", "no", ""
   :config:option:`dir/user/TlsCaCertificateDir`\              , "= DIRECTORY", "", ""
   :config:option:`dir/user/TlsCaCertificateFile`\             , "= DIRECTORY", "", ""
   :config:option:`dir/user/TlsCertificate`\                   , "= DIRECTORY", "", ""
   :config:option:`dir/user/TlsCertificateRevocationList`\     , "= DIRECTORY", "", ""
   :config:option:`dir/user/TlsCipherList`\                    , "= DIRECTORY", "", ""
   :config:option:`dir/user/TlsDhFile`\                        , "= DIRECTORY", "", ""
   :config:option:`dir/user/TlsEnable`\                        , "= BOOLEAN", "yes", ""
   :config:option:`dir/user/TlsKey`\                           , "= DIRECTORY", "", ""
   :config:option:`dir/user/TlsRequire`\                       , "= BOOLEAN", "no", ""
   :config:option:`dir/user/TlsVerifyPeer`\                    , "= BOOLEAN", "no", ""
   :config:option:`dir/user/UsePamAuthentication`\             , "= BOOLEAN", "no", ""
   :config:option:`dir/user/WhereACL`\                         , "= ACL", "", ""

