.. csv-table::
   :header: "configuration directive name", "type of data", "default value", "remark"

   :config:option:`sd/director/Description`\                   , "= STRING", "", ""
   :config:option:`sd/director/KeyEncryptionKey`\              , "= AUTOPASSWORD", "", ""
   :config:option:`sd/director/MaximumBandwidthPerJob`\        , "= SPEED", "", ""
   :config:option:`sd/director/Monitor`\                       , "= BOOLEAN", "", ""
   :config:option:`sd/director/Name`\                          , "**= NAME** ", "", "**required** "
   :config:option:`sd/director/Password`\                      , "**= AUTOPASSWORD** ", "", "**required** "
   :config:option:`sd/director/TlsAllowedCn`\                  , "= STRING_LIST", "", ""
   :config:option:`sd/director/TlsAuthenticate`\               , "= BOOLEAN", "no", ""
   :config:option:`sd/director/TlsCaCertificateDir`\           , "= DIRECTORY", "", ""
   :config:option:`sd/director/TlsCaCertificateFile`\          , "= DIRECTORY", "", ""
   :config:option:`sd/director/TlsCertificate`\                , "= DIRECTORY", "", ""
   :config:option:`sd/director/TlsCertificateRevocationList`\  , "= DIRECTORY", "", ""
   :config:option:`sd/director/TlsCipherList`\                 , "= DIRECTORY", "", ""
   :config:option:`sd/director/TlsDhFile`\                     , "= DIRECTORY", "", ""
   :config:option:`sd/director/TlsEnable`\                     , "= BOOLEAN", "yes", ""
   :config:option:`sd/director/TlsKey`\                        , "= DIRECTORY", "", ""
   :config:option:`sd/director/TlsRequire`\                    , "= BOOLEAN", "no", ""
   :config:option:`sd/director/TlsVerifyPeer`\                 , "= BOOLEAN", "no", ""

