.. csv-table::
   :header: "configuration directive name", "type of data", "default value", "remark"

   :config:option:`dir/director/AbsoluteJobTimeout`\           , "= PINT32", "", ""
   :config:option:`dir/director/AuditEvents`\                  , "= AUDIT_COMMAND_LIST", "", ""
   :config:option:`dir/director/Auditing`\                     , "= BOOLEAN", "no", ""
   :config:option:`dir/director/BackendDirectory`\             , "= DIRECTORY_LIST", "/usr/local/lib64/bareos/backends *(platform specific)*", ""
   :config:option:`dir/director/Description`\                  , "= STRING", "", ""
   :config:option:`dir/director/DirAddress`\                   , "= ADDRESS", "9101", ""
   :config:option:`dir/director/DirAddresses`\                 , "= ADDRESSES", "9101", ""
   :config:option:`dir/director/DirPort`\                      , "= PORT", "9101", ""
   :config:option:`dir/director/DirSourceAddress`\             , "= ADDRESS", "0", ""
   :config:option:`dir/director/FdConnectTimeout`\             , "= TIME", "180", ""
   :config:option:`dir/director/HeartbeatInterval`\            , "= TIME", "0", ""
   :config:option:`dir/director/KeyEncryptionKey`\             , "= AUTOPASSWORD", "", ""
   :config:option:`dir/director/LogTimestampFormat`\           , "= STRING", "", ""
   :config:option:`dir/director/MaximumConcurrentJobs`\        , "= PINT32", "1", ""
   :config:option:`dir/director/MaximumConnections`\           , "= PINT32", "30", ""
   :config:option:`dir/director/MaximumConsoleConnections`\    , "= PINT32", "20", ""
   :config:option:`dir/director/Messages`\                     , "= RES", "", ""
   :config:option:`dir/director/Name`\                         , "**= NAME** ", "", "**required** "
   :config:option:`dir/director/NdmpLogLevel`\                 , "= PINT32", "4", ""
   :config:option:`dir/director/NdmpSnooping`\                 , "= BOOLEAN", "", ""
   :config:option:`dir/director/OmitDefaults`\                 , "*= BOOLEAN* ", "*yes* ", "*deprecated* "
   :config:option:`dir/director/OptimizeForSize`\              , "= BOOLEAN", "no", ""
   :config:option:`dir/director/OptimizeForSpeed`\             , "= BOOLEAN", "no", ""
   :config:option:`dir/director/Password`\                     , "**= AUTOPASSWORD** ", "", "**required** "
   :config:option:`dir/director/PidDirectory`\                 , "= DIRECTORY", "/var/lib/bareos *(platform specific)*", ""
   :config:option:`dir/director/PluginDirectory`\              , "= DIRECTORY", "", ""
   :config:option:`dir/director/PluginNames`\                  , "= PLUGIN_NAMES", "", ""
   :config:option:`dir/director/QueryFile`\                    , "**= DIRECTORY** ", "", "**required** "
   :config:option:`dir/director/ScriptsDirectory`\             , "= DIRECTORY", "", ""
   :config:option:`dir/director/SdConnectTimeout`\             , "= TIME", "1800", ""
   :config:option:`dir/director/SecureEraseCommand`\           , "= STRING", "", ""
   :config:option:`dir/director/StatisticsCollectInterval`\    , "= PINT32", "150", ""
   :config:option:`dir/director/StatisticsRetention`\          , "= TIME", "160704000", ""
   :config:option:`dir/director/SubSysDirectory`\              , "*= DIRECTORY* ", "", "*deprecated* "
   :config:option:`dir/director/Subscriptions`\                , "= PINT32", "0", ""
   :config:option:`dir/director/TlsAllowedCn`\                 , "= STRING_LIST", "", ""
   :config:option:`dir/director/TlsAuthenticate`\              , "= BOOLEAN", "no", ""
   :config:option:`dir/director/TlsCaCertificateDir`\          , "= DIRECTORY", "", ""
   :config:option:`dir/director/TlsCaCertificateFile`\         , "= DIRECTORY", "", ""
   :config:option:`dir/director/TlsCertificate`\               , "= DIRECTORY", "", ""
   :config:option:`dir/director/TlsCertificateRevocationList`\ , "= DIRECTORY", "", ""
   :config:option:`dir/director/TlsCipherList`\                , "= DIRECTORY", "", ""
   :config:option:`dir/director/TlsDhFile`\                    , "= DIRECTORY", "", ""
   :config:option:`dir/director/TlsEnable`\                    , "= BOOLEAN", "yes", ""
   :config:option:`dir/director/TlsKey`\                       , "= DIRECTORY", "", ""
   :config:option:`dir/director/TlsRequire`\                   , "= BOOLEAN", "no", ""
   :config:option:`dir/director/TlsVerifyPeer`\                , "= BOOLEAN", "no", ""
   :config:option:`dir/director/VerId`\                        , "= STRING", "", ""
   :config:option:`dir/director/WorkingDirectory`\             , "= DIRECTORY", "/var/lib/bareos *(platform specific)*", ""

