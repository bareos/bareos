.. csv-table::
   :header: "configuration directive name", "type of data", "default value", "remark"

   :config:option:`console/console/Description`\               , "= STRING", "", ""
   :config:option:`console/console/Director`\                  , "= STRING", "", ""
   :config:option:`console/console/HeartbeatInterval`\         , "= TIME", "0", ""
   :config:option:`console/console/HistoryFile`\               , "= DIRECTORY", "", ""
   :config:option:`console/console/HistoryLength`\             , "= PINT32", "100", ""
   :config:option:`console/console/Name`\                      , "**= NAME** ", "", "**required** "
   :config:option:`console/console/Password`\                  , "**= MD5PASSWORD** ", "", "**required** "
   :config:option:`console/console/RcFile`\                    , "= DIRECTORY", "", ""
   :config:option:`console/console/TlsAllowedCn`\              , "= STRING_LIST", "", ""
   :config:option:`console/console/TlsAuthenticate`\           , "= BOOLEAN", "no", ""
   :config:option:`console/console/TlsCaCertificateDir`\       , "= DIRECTORY", "", ""
   :config:option:`console/console/TlsCaCertificateFile`\      , "= DIRECTORY", "", ""
   :config:option:`console/console/TlsCertificate`\            , "= DIRECTORY", "", ""
   :config:option:`console/console/TlsCertificateRevocationList`\ , "= DIRECTORY", "", ""
   :config:option:`console/console/TlsCipherList`\             , "= DIRECTORY", "", ""
   :config:option:`console/console/TlsDhFile`\                 , "= DIRECTORY", "", ""
   :config:option:`console/console/TlsEnable`\                 , "= BOOLEAN", "yes", ""
   :config:option:`console/console/TlsKey`\                    , "= DIRECTORY", "", ""
   :config:option:`console/console/TlsRequire`\                , "= BOOLEAN", "no", ""
   :config:option:`console/console/TlsVerifyPeer`\             , "= BOOLEAN", "no", ""

