.. csv-table::
   :header: "configuration directive name", "type of data", "default value", "remark"

   :config:option:`dir/pool/ActionOnPurge`\                    , "= ACTION_ON_PURGE", "", ""
   :config:option:`dir/pool/AutoPrune`\                        , "= BOOLEAN", "yes", ""
   :config:option:`dir/pool/Catalog`\                          , "= RES", "", ""
   :config:option:`dir/pool/CatalogFiles`\                     , "= BOOLEAN", "yes", ""
   :config:option:`dir/pool/CleaningPrefix`\                   , "= STRNAME", "CLN", ""
   :config:option:`dir/pool/Description`\                      , "= STRING", "", ""
   :config:option:`dir/pool/FileRetention`\                    , "= TIME", "", ""
   :config:option:`dir/pool/JobRetention`\                     , "= TIME", "", ""
   :config:option:`dir/pool/LabelFormat`\                      , "= STRNAME", "", ""
   :config:option:`dir/pool/LabelType`\                        , "= LABEL", "", ""
   :config:option:`dir/pool/MaximumBlockSize`\                 , "= SIZE32", "", ""
   :config:option:`dir/pool/MaximumVolumeBytes`\               , "= SIZE64", "", ""
   :config:option:`dir/pool/MaximumVolumeFiles`\               , "= PINT32", "", ""
   :config:option:`dir/pool/MaximumVolumeJobs`\                , "= PINT32", "", ""
   :config:option:`dir/pool/MaximumVolumes`\                   , "= PINT32", "", ""
   :config:option:`dir/pool/MigrationHighBytes`\               , "= SIZE64", "", ""
   :config:option:`dir/pool/MigrationLowBytes`\                , "= SIZE64", "", ""
   :config:option:`dir/pool/MigrationTime`\                    , "= TIME", "", ""
   :config:option:`dir/pool/MinimumBlockSize`\                 , "= SIZE32", "", ""
   :config:option:`dir/pool/Name`\                             , "**= NAME** ", "", "**required** "
   :config:option:`dir/pool/NextPool`\                         , "= RES", "", ""
   :config:option:`dir/pool/PoolType`\                         , "= POOLTYPE", "Backup", ""
   :config:option:`dir/pool/PurgeOldestVolume`\                , "= BOOLEAN", "no", ""
   :config:option:`dir/pool/Recycle`\                          , "= BOOLEAN", "yes", ""
   :config:option:`dir/pool/RecycleCurrentVolume`\             , "= BOOLEAN", "no", ""
   :config:option:`dir/pool/RecycleOldestVolume`\              , "= BOOLEAN", "no", ""
   :config:option:`dir/pool/RecyclePool`\                      , "= RES", "", ""
   :config:option:`dir/pool/ScratchPool`\                      , "= RES", "", ""
   :config:option:`dir/pool/Storage`\                          , "= RESOURCE_LIST", "", ""
   :config:option:`dir/pool/UseCatalog`\                       , "= BOOLEAN", "yes", ""
   :config:option:`dir/pool/UseVolumeOnce`\                    , "*= BOOLEAN* ", "", "*deprecated* "
   :config:option:`dir/pool/VolumeRetention`\                  , "= TIME", "31536000", ""
   :config:option:`dir/pool/VolumeUseDuration`\                , "= TIME", "", ""

