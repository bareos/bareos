.. csv-table::
   :header: "configuration directive name", "type of data", "default value", "remark"

   :config:option:`sd/storage/AbsoluteJobTimeout`\             , "= PINT32", "", ""
   :config:option:`sd/storage/AllowBandwidthBursting`\         , "= BOOLEAN", "no", ""
   :config:option:`sd/storage/AutoXFlateOnReplication`\        , "= BOOLEAN", "no", ""
   :config:option:`sd/storage/BackendDirectory`\               , "= DIRECTORY_LIST", "/usr/local/lib64/bareos/backends *(platform specific)*", ""
   :config:option:`sd/storage/ClientConnectWait`\              , "= TIME", "1800", ""
   :config:option:`sd/storage/CollectDeviceStatistics`\        , "= BOOLEAN", "no", ""
   :config:option:`sd/storage/CollectJobStatistics`\           , "= BOOLEAN", "no", ""
   :config:option:`sd/storage/Compatible`\                     , "= BOOLEAN", "no", ""
   :config:option:`sd/storage/Description`\                    , "= STRING", "", ""
   :config:option:`sd/storage/DeviceReserveByMediaType`\       , "= BOOLEAN", "no", ""
   :config:option:`sd/storage/FdConnectTimeout`\               , "= TIME", "1800", ""
   :config:option:`sd/storage/FileDeviceConcurrentRead`\       , "= BOOLEAN", "no", ""
   :config:option:`sd/storage/HeartbeatInterval`\              , "= TIME", "0", ""
   :config:option:`sd/storage/LogTimestampFormat`\             , "= STRING", "", ""
   :config:option:`sd/storage/MaximumBandwidthPerJob`\         , "= SPEED", "", ""
   :config:option:`sd/storage/MaximumConcurrentJobs`\          , "= PINT32", "20", ""
   :config:option:`sd/storage/MaximumConnections`\             , "= PINT32", "42", ""
   :config:option:`sd/storage/MaximumNetworkBufferSize`\       , "= PINT32", "", ""
   :config:option:`sd/storage/Messages`\                       , "= RES", "", ""
   :config:option:`sd/storage/Name`\                           , "**= NAME** ", "", "**required** "
   :config:option:`sd/storage/NdmpAddress`\                    , "= ADDRESS", "10000", ""
   :config:option:`sd/storage/NdmpAddresses`\                  , "= ADDRESSES", "10000", ""
   :config:option:`sd/storage/NdmpEnable`\                     , "= BOOLEAN", "no", ""
   :config:option:`sd/storage/NdmpLogLevel`\                   , "= PINT32", "4", ""
   :config:option:`sd/storage/NdmpPort`\                       , "= PORT", "10000", ""
   :config:option:`sd/storage/NdmpSnooping`\                   , "= BOOLEAN", "no", ""
   :config:option:`sd/storage/PidDirectory`\                   , "= DIRECTORY", "/var/lib/bareos *(platform specific)*", ""
   :config:option:`sd/storage/PluginDirectory`\                , "= DIRECTORY", "", ""
   :config:option:`sd/storage/PluginNames`\                    , "= PLUGIN_NAMES", "", ""
   :config:option:`sd/storage/ScriptsDirectory`\               , "= DIRECTORY", "", ""
   :config:option:`sd/storage/SdAddress`\                      , "= ADDRESS", "9103", ""
   :config:option:`sd/storage/SdAddresses`\                    , "= ADDRESSES", "9103", ""
   :config:option:`sd/storage/SdConnectTimeout`\               , "= TIME", "1800", ""
   :config:option:`sd/storage/SdPort`\                         , "= PORT", "9103", ""
   :config:option:`sd/storage/SdSourceAddress`\                , "= ADDRESS", "0", ""
   :config:option:`sd/storage/SecureEraseCommand`\             , "= STRING", "", ""
   :config:option:`sd/storage/StatisticsCollectInterval`\      , "= PINT32", "30", ""
   :config:option:`sd/storage/SubSysDirectory`\                , "= DIRECTORY", "", ""
   :config:option:`sd/storage/TlsAllowedCn`\                   , "= STRING_LIST", "", ""
   :config:option:`sd/storage/TlsAuthenticate`\                , "= BOOLEAN", "no", ""
   :config:option:`sd/storage/TlsCaCertificateDir`\            , "= DIRECTORY", "", ""
   :config:option:`sd/storage/TlsCaCertificateFile`\           , "= DIRECTORY", "", ""
   :config:option:`sd/storage/TlsCertificate`\                 , "= DIRECTORY", "", ""
   :config:option:`sd/storage/TlsCertificateRevocationList`\   , "= DIRECTORY", "", ""
   :config:option:`sd/storage/TlsCipherList`\                  , "= DIRECTORY", "", ""
   :config:option:`sd/storage/TlsDhFile`\                      , "= DIRECTORY", "", ""
   :config:option:`sd/storage/TlsEnable`\                      , "= BOOLEAN", "yes", ""
   :config:option:`sd/storage/TlsKey`\                         , "= DIRECTORY", "", ""
   :config:option:`sd/storage/TlsRequire`\                     , "= BOOLEAN", "no", ""
   :config:option:`sd/storage/TlsVerifyPeer`\                  , "= BOOLEAN", "no", ""
   :config:option:`sd/storage/VerId`\                          , "= STRING", "", ""
   :config:option:`sd/storage/WorkingDirectory`\               , "= DIRECTORY", "/var/lib/bareos *(platform specific)*", ""

