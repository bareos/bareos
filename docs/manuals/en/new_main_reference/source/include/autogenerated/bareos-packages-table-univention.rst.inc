.. index::
   single: Platform; Univention; 4.0
   single: Platform; Univention; 4.2
   single: Platform; Univention; 4.3

.. csv-table::
   :header: "", "Univention 4.0", "Univention 4.2", "Univention 4.3"

   bareos, 15.2-16.2, 17.2, 18.2
   bareos-bat, 15.2-16.2,  ,  
   bareos-bconsole, 15.2-16.2, 17.2, 18.2
   bareos-client, 15.2-16.2, 17.2, 18.2
   bareos-common, 15.2-16.2, 17.2, 18.2
   bareos-database-common, 15.2-16.2, 17.2, 18.2
   bareos-database-mysql, 15.2-16.2, 17.2, 18.2
   bareos-database-postgresql, 15.2-16.2, 17.2, 18.2
   bareos-database-sqlite3, 15.2-16.2, 17.2, 18.2
   bareos-database-tools, 15.2-16.2, 17.2, 18.2
   bareos-director, 15.2-16.2, 17.2, 18.2
   bareos-director-python-plugin, 15.2-16.2, 17.2, 18.2
   bareos-filedaemon, 15.2-16.2, 17.2, 18.2
   bareos-filedaemon-ceph-plugin,  ,  , 18.2
   bareos-filedaemon-glusterfs-plugin,  , 17.2,  
   bareos-filedaemon-ldap-python-plugin, 15.2-16.2, 17.2, 18.2
   bareos-filedaemon-python-plugin, 15.2-16.2, 17.2, 18.2
   bareos-regress-config,  , 17.2, 18.2
   bareos-storage, 15.2-16.2, 17.2, 18.2
   bareos-storage-ceph,  ,  , 18.2
   bareos-storage-fifo, 15.2-16.2, 17.2, 18.2
   bareos-storage-glusterfs,  , 17.2,  
   bareos-storage-python-plugin, 15.2-16.2, 17.2, 18.2
   bareos-storage-tape, 15.2-16.2, 17.2, 18.2
   bareos-tools, 15.2-16.2, 17.2, 18.2
   bareos-traymonitor, 15.2-16.2, 17.2, 18.2
   bareos-vadp-dumper,  ,  , 18.2
   bareos-vmware-plugin,  ,  , 18.2
   bareos-vmware-plugin-compat,  ,  , 18.2
   bareos-vmware-vix-disklib,  , 17.2,  
   bareos-webui, 15.2-16.2, 17.2, 18.2
   libfastlz, 15.2-16.2, 17.2, 18.2
   python-bareos,  , 17.2, 18.2
   univention-bareos, 15.2-16.2, 17.2,  

