.. csv-table::
   :header: "configuration directive name", "type of data", "default value", "remark"

   :config:option:`fd/director/Address`\                       , "= STRING", "", ""
   :config:option:`fd/director/AllowedJobCommand`\             , "= STRING_LIST", "", ""
   :config:option:`fd/director/AllowedScriptDir`\              , "= DIRECTORY_LIST", "", ""
   :config:option:`fd/director/ConnectionFromClientToDirector`\ , "= BOOLEAN", "no", ""
   :config:option:`fd/director/ConnectionFromDirectorToClient`\ , "= BOOLEAN", "yes", ""
   :config:option:`fd/director/Description`\                   , "= STRING", "", ""
   :config:option:`fd/director/MaximumBandwidthPerJob`\        , "= SPEED", "", ""
   :config:option:`fd/director/Monitor`\                       , "= BOOLEAN", "no", ""
   :config:option:`fd/director/Name`\                          , "**= NAME** ", "", "**required** "
   :config:option:`fd/director/Password`\                      , "**= MD5PASSWORD** ", "", "**required** "
   :config:option:`fd/director/Port`\                          , "= PINT32", "9101", ""
   :config:option:`fd/director/TlsAllowedCn`\                  , "= STRING_LIST", "", ""
   :config:option:`fd/director/TlsAuthenticate`\               , "= BOOLEAN", "no", ""
   :config:option:`fd/director/TlsCaCertificateDir`\           , "= DIRECTORY", "", ""
   :config:option:`fd/director/TlsCaCertificateFile`\          , "= DIRECTORY", "", ""
   :config:option:`fd/director/TlsCertificate`\                , "= DIRECTORY", "", ""
   :config:option:`fd/director/TlsCertificateRevocationList`\  , "= DIRECTORY", "", ""
   :config:option:`fd/director/TlsCipherList`\                 , "= DIRECTORY", "", ""
   :config:option:`fd/director/TlsDhFile`\                     , "= DIRECTORY", "", ""
   :config:option:`fd/director/TlsEnable`\                     , "= BOOLEAN", "yes", ""
   :config:option:`fd/director/TlsKey`\                        , "= DIRECTORY", "", ""
   :config:option:`fd/director/TlsRequire`\                    , "= BOOLEAN", "no", ""
   :config:option:`fd/director/TlsVerifyPeer`\                 , "= BOOLEAN", "no", ""

