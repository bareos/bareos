.. csv-table::
   :header: "configuration directive name", "type of data", "default value", "remark"

   :config:option:`console/monitor/Description`\               , "= STRING", "", ""
   :config:option:`console/monitor/DirConnectTimeout`\         , "= TIME", "10", ""
   :config:option:`console/monitor/FdConnectTimeout`\          , "= TIME", "10", ""
   :config:option:`console/monitor/Name`\                      , "**= NAME** ", "", "**required** "
   :config:option:`console/monitor/Password`\                  , "**= MD5PASSWORD** ", "", "**required** "
   :config:option:`console/monitor/RefreshInterval`\           , "= TIME", "60", ""
   :config:option:`console/monitor/SdConnectTimeout`\          , "= TIME", "10", ""
   :config:option:`console/monitor/TlsAllowedCn`\              , "= STRING_LIST", "", ""
   :config:option:`console/monitor/TlsAuthenticate`\           , "= BOOLEAN", "no", ""
   :config:option:`console/monitor/TlsCaCertificateDir`\       , "= DIRECTORY", "", ""
   :config:option:`console/monitor/TlsCaCertificateFile`\      , "= DIRECTORY", "", ""
   :config:option:`console/monitor/TlsCertificate`\            , "= DIRECTORY", "", ""
   :config:option:`console/monitor/TlsCertificateRevocationList`\ , "= DIRECTORY", "", ""
   :config:option:`console/monitor/TlsCipherList`\             , "= DIRECTORY", "", ""
   :config:option:`console/monitor/TlsDhFile`\                 , "= DIRECTORY", "", ""
   :config:option:`console/monitor/TlsEnable`\                 , "= BOOLEAN", "yes", ""
   :config:option:`console/monitor/TlsKey`\                    , "= DIRECTORY", "", ""
   :config:option:`console/monitor/TlsRequire`\                , "= BOOLEAN", "no", ""
   :config:option:`console/monitor/TlsVerifyPeer`\             , "= BOOLEAN", "no", ""

