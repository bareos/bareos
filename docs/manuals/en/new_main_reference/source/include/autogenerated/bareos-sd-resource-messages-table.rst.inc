.. csv-table::
   :header: "configuration directive name", "type of data", "default value", "remark"

   :config:option:`sd/messages/Append`\                        , "= MESSAGES", "", ""
   :config:option:`sd/messages/Catalog`\                       , "= MESSAGES", "", ""
   :config:option:`sd/messages/Console`\                       , "= MESSAGES", "", ""
   :config:option:`sd/messages/Description`\                   , "= STRING", "", ""
   :config:option:`sd/messages/Director`\                      , "= MESSAGES", "", ""
   :config:option:`sd/messages/File`\                          , "= MESSAGES", "", ""
   :config:option:`sd/messages/Mail`\                          , "= MESSAGES", "", ""
   :config:option:`sd/messages/MailCommand`\                   , "= STRING", "", ""
   :config:option:`sd/messages/MailOnError`\                   , "= MESSAGES", "", ""
   :config:option:`sd/messages/MailOnSuccess`\                 , "= MESSAGES", "", ""
   :config:option:`sd/messages/Name`\                          , "= NAME", "", ""
   :config:option:`sd/messages/Operator`\                      , "= MESSAGES", "", ""
   :config:option:`sd/messages/OperatorCommand`\               , "= STRING", "", ""
   :config:option:`sd/messages/Stderr`\                        , "= MESSAGES", "", ""
   :config:option:`sd/messages/Stdout`\                        , "= MESSAGES", "", ""
   :config:option:`sd/messages/Syslog`\                        , "= MESSAGES", "", ""
   :config:option:`sd/messages/TimestampFormat`\               , "= STRING", "", ""

