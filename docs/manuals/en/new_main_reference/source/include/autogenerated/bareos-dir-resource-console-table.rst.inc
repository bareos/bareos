.. csv-table::
   :header: "configuration directive name", "type of data", "default value", "remark"

   :config:option:`dir/console/CatalogACL`\                    , "= ACL", "", ""
   :config:option:`dir/console/ClientACL`\                     , "= ACL", "", ""
   :config:option:`dir/console/CommandACL`\                    , "= ACL", "", ""
   :config:option:`dir/console/Description`\                   , "= STRING", "", ""
   :config:option:`dir/console/FileSetACL`\                    , "= ACL", "", ""
   :config:option:`dir/console/JobACL`\                        , "= ACL", "", ""
   :config:option:`dir/console/Name`\                          , "**= NAME** ", "", "**required** "
   :config:option:`dir/console/Password`\                      , "**= AUTOPASSWORD** ", "", "**required** "
   :config:option:`dir/console/PluginOptionsACL`\              , "= ACL", "", ""
   :config:option:`dir/console/PoolACL`\                       , "= ACL", "", ""
   :config:option:`dir/console/Profile`\                       , "= RESOURCE_LIST", "", ""
   :config:option:`dir/console/RunACL`\                        , "= ACL", "", ""
   :config:option:`dir/console/ScheduleACL`\                   , "= ACL", "", ""
   :config:option:`dir/console/StorageACL`\                    , "= ACL", "", ""
   :config:option:`dir/console/TlsAllowedCn`\                  , "= STRING_LIST", "", ""
   :config:option:`dir/console/TlsAuthenticate`\               , "= BOOLEAN", "no", ""
   :config:option:`dir/console/TlsCaCertificateDir`\           , "= DIRECTORY", "", ""
   :config:option:`dir/console/TlsCaCertificateFile`\          , "= DIRECTORY", "", ""
   :config:option:`dir/console/TlsCertificate`\                , "= DIRECTORY", "", ""
   :config:option:`dir/console/TlsCertificateRevocationList`\  , "= DIRECTORY", "", ""
   :config:option:`dir/console/TlsCipherList`\                 , "= DIRECTORY", "", ""
   :config:option:`dir/console/TlsDhFile`\                     , "= DIRECTORY", "", ""
   :config:option:`dir/console/TlsEnable`\                     , "= BOOLEAN", "yes", ""
   :config:option:`dir/console/TlsKey`\                        , "= DIRECTORY", "", ""
   :config:option:`dir/console/TlsRequire`\                    , "= BOOLEAN", "no", ""
   :config:option:`dir/console/TlsVerifyPeer`\                 , "= BOOLEAN", "no", ""
   :config:option:`dir/console/UsePamAuthentication`\          , "= BOOLEAN", "no", ""
   :config:option:`dir/console/WhereACL`\                      , "= ACL", "", ""

