.. config:option:: sd/messages/Append

   :type: MESSAGES

   .. include:: /config-directive-description/sd-messages-Append.rst.inc



.. config:option:: sd/messages/Catalog

   :type: MESSAGES

   .. include:: /config-directive-description/sd-messages-Catalog.rst.inc



.. config:option:: sd/messages/Console

   :type: MESSAGES

   .. include:: /config-directive-description/sd-messages-Console.rst.inc



.. config:option:: sd/messages/Description

   :type: STRING

   .. include:: /config-directive-description/sd-messages-Description.rst.inc



.. config:option:: sd/messages/Director

   :type: MESSAGES

   .. include:: /config-directive-description/sd-messages-Director.rst.inc



.. config:option:: sd/messages/File

   :type: MESSAGES

   .. include:: /config-directive-description/sd-messages-File.rst.inc



.. config:option:: sd/messages/Mail

   :type: MESSAGES

   .. include:: /config-directive-description/sd-messages-Mail.rst.inc



.. config:option:: sd/messages/MailCommand

   :type: STRING

   .. include:: /config-directive-description/sd-messages-MailCommand.rst.inc



.. config:option:: sd/messages/MailOnError

   :type: MESSAGES

   .. include:: /config-directive-description/sd-messages-MailOnError.rst.inc



.. config:option:: sd/messages/MailOnSuccess

   :type: MESSAGES

   .. include:: /config-directive-description/sd-messages-MailOnSuccess.rst.inc



.. config:option:: sd/messages/Name

   :type: NAME

   .. include:: /config-directive-description/sd-messages-Name.rst.inc



.. config:option:: sd/messages/Operator

   :type: MESSAGES

   .. include:: /config-directive-description/sd-messages-Operator.rst.inc



.. config:option:: sd/messages/OperatorCommand

   :type: STRING

   .. include:: /config-directive-description/sd-messages-OperatorCommand.rst.inc



.. config:option:: sd/messages/Stderr

   :type: MESSAGES

   .. include:: /config-directive-description/sd-messages-Stderr.rst.inc



.. config:option:: sd/messages/Stdout

   :type: MESSAGES

   .. include:: /config-directive-description/sd-messages-Stdout.rst.inc



.. config:option:: sd/messages/Syslog

   :type: MESSAGES

   .. include:: /config-directive-description/sd-messages-Syslog.rst.inc



.. config:option:: sd/messages/TimestampFormat

   :type: STRING

   .. include:: /config-directive-description/sd-messages-TimestampFormat.rst.inc



