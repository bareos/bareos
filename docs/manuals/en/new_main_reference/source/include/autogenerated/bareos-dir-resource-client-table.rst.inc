.. csv-table::
   :header: "configuration directive name", "type of data", "default value", "remark"

   :config:option:`dir/client/Address`\                        , "**= STRING** ", "", "**required** "
   :config:option:`dir/client/AllowClientConnect`\             , "*= BOOLEAN* ", "", "*alias, deprecated* "
   :config:option:`dir/client/AuthType`\                       , "= AUTH_TYPE", "None", ""
   :config:option:`dir/client/AutoPrune`\                      , "= BOOLEAN", "no", ""
   :config:option:`dir/client/Catalog`\                        , "= RES", "", ""
   :config:option:`dir/client/ConnectionFromClientToDirector`\ , "= BOOLEAN", "no", ""
   :config:option:`dir/client/ConnectionFromDirectorToClient`\ , "= BOOLEAN", "yes", ""
   :config:option:`dir/client/Description`\                    , "= STRING", "", ""
   :config:option:`dir/client/Enabled`\                        , "= BOOLEAN", "yes", ""
   :config:option:`dir/client/FdAddress`\                      , "*= STRING* ", "", "*alias* "
   :config:option:`dir/client/FdPassword`\                     , "*= AUTOPASSWORD* ", "", "*alias* "
   :config:option:`dir/client/FdPort`\                         , "*= PINT32* ", "*9102* ", "*alias* "
   :config:option:`dir/client/FileRetention`\                  , "= TIME", "5184000", ""
   :config:option:`dir/client/HardQuota`\                      , "= SIZE64", "0", ""
   :config:option:`dir/client/HeartbeatInterval`\              , "= TIME", "0", ""
   :config:option:`dir/client/JobRetention`\                   , "= TIME", "15552000", ""
   :config:option:`dir/client/LanAddress`\                     , "= STRING", "", ""
   :config:option:`dir/client/MaximumBandwidthPerJob`\         , "= SPEED", "", ""
   :config:option:`dir/client/MaximumConcurrentJobs`\          , "= PINT32", "1", ""
   :config:option:`dir/client/Name`\                           , "**= NAME** ", "", "**required** "
   :config:option:`dir/client/NdmpBlockSize`\                  , "= SIZE32", "64512", ""
   :config:option:`dir/client/NdmpLogLevel`\                   , "= PINT32", "4", ""
   :config:option:`dir/client/NdmpUseLmdb`\                    , "= BOOLEAN", "yes", ""
   :config:option:`dir/client/Passive`\                        , "= BOOLEAN", "no", ""
   :config:option:`dir/client/Password`\                       , "**= AUTOPASSWORD** ", "", "**required** "
   :config:option:`dir/client/Port`\                           , "= PINT32", "9102", ""
   :config:option:`dir/client/Protocol`\                       , "= AUTH_PROTOCOL_TYPE", "Native", ""
   :config:option:`dir/client/QuotaIncludeFailedJobs`\         , "= BOOLEAN", "yes", ""
   :config:option:`dir/client/SoftQuota`\                      , "= SIZE64", "0", ""
   :config:option:`dir/client/SoftQuotaGracePeriod`\           , "= TIME", "0", ""
   :config:option:`dir/client/StrictQuotas`\                   , "= BOOLEAN", "no", ""
   :config:option:`dir/client/TlsAllowedCn`\                   , "= STRING_LIST", "", ""
   :config:option:`dir/client/TlsAuthenticate`\                , "= BOOLEAN", "no", ""
   :config:option:`dir/client/TlsCaCertificateDir`\            , "= DIRECTORY", "", ""
   :config:option:`dir/client/TlsCaCertificateFile`\           , "= DIRECTORY", "", ""
   :config:option:`dir/client/TlsCertificate`\                 , "= DIRECTORY", "", ""
   :config:option:`dir/client/TlsCertificateRevocationList`\   , "= DIRECTORY", "", ""
   :config:option:`dir/client/TlsCipherList`\                  , "= DIRECTORY", "", ""
   :config:option:`dir/client/TlsDhFile`\                      , "= DIRECTORY", "", ""
   :config:option:`dir/client/TlsEnable`\                      , "= BOOLEAN", "yes", ""
   :config:option:`dir/client/TlsKey`\                         , "= DIRECTORY", "", ""
   :config:option:`dir/client/TlsRequire`\                     , "= BOOLEAN", "no", ""
   :config:option:`dir/client/TlsVerifyPeer`\                  , "= BOOLEAN", "no", ""
   :config:option:`dir/client/Username`\                       , "= STRING", "", ""

