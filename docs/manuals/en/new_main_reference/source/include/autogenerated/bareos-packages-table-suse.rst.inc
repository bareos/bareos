.. index::
   single: Platform; SLES; 10sp4
   single: Platform; SLES; 11sp4
   single: Platform; SLES; 12sp1
   single: Platform; SLES; 12sp2
   single: Platform; SLES; 12sp3
   single: Platform; SLES; 12sp4

.. csv-table::
   :header: "", "SLES 10sp4", "SLES 11sp4", "SLES 12sp1", "SLES 12sp2", "SLES 12sp3", "SLES 12sp4"

   bareos, 14.2, 14.2-17.2, 14.2-17.2, 17.2, 17.2-18.2, 18.2
   bareos-bat,  , 14.2-16.2, 14.2-16.2,  ,  ,  
   bareos-bconsole, 14.2, 14.2-17.2, 14.2-17.2, 17.2, 17.2-18.2, 18.2
   bareos-client, 14.2, 14.2-17.2, 14.2-17.2, 17.2, 17.2-18.2, 18.2
   bareos-common, 14.2, 14.2-17.2, 14.2-17.2, 17.2, 17.2-18.2, 18.2
   bareos-database-common, 14.2, 14.2-17.2, 14.2-17.2, 17.2, 17.2-18.2, 18.2
   bareos-database-mysql, 14.2, 14.2-17.2, 14.2-17.2, 17.2, 17.2-18.2, 18.2
   bareos-database-postgresql, 14.2, 14.2-17.2, 14.2-17.2, 17.2, 17.2-18.2, 18.2
   bareos-database-sqlite3,  , 14.2-17.2, 14.2-17.2, 17.2, 17.2-18.2, 18.2
   bareos-database-tools, 14.2, 14.2-17.2, 14.2-17.2, 17.2, 17.2-18.2, 18.2
   bareos-director, 14.2, 14.2-17.2, 14.2-17.2, 17.2, 17.2-18.2, 18.2
   bareos-director-python-plugin,  , 14.2-17.2, 14.2-17.2, 17.2, 17.2-18.2, 18.2
   bareos-filedaemon, 14.2, 14.2-17.2, 14.2-17.2, 17.2, 17.2-18.2, 18.2
   bareos-filedaemon-ceph-plugin,  ,  , 15.2-17.2,  , 18.2, 18.2
   bareos-filedaemon-ldap-python-plugin,  , 15.2-17.2, 15.2-17.2, 17.2, 17.2-18.2, 18.2
   bareos-filedaemon-python-plugin,  , 14.2-17.2, 14.2-17.2, 17.2, 17.2-18.2, 18.2
   bareos-regress-config,  , 17.2, 17.2, 17.2, 17.2-18.2, 18.2
   bareos-storage, 14.2, 14.2-17.2, 14.2-17.2, 17.2, 17.2-18.2, 18.2
   bareos-storage-ceph,  ,  , 15.2-17.2,  , 18.2, 18.2
   bareos-storage-droplet,  ,  , 17.2, 17.2, 17.2-18.2, 18.2
   bareos-storage-fifo, 14.2, 14.2-17.2, 14.2-17.2, 17.2, 17.2-18.2, 18.2
   bareos-storage-python-plugin,  , 14.2-17.2, 14.2-17.2, 17.2, 17.2-18.2, 18.2
   bareos-storage-tape, 14.2, 14.2-17.2, 14.2-17.2, 17.2, 17.2-18.2, 18.2
   bareos-tools, 14.2, 14.2-17.2, 14.2-17.2, 17.2, 17.2-18.2, 18.2
   bareos-traymonitor,  , 14.2-17.2, 14.2-17.2, 17.2, 17.2-18.2, 18.2
   bareos-vadp-dumper,  , 15.2-16.2, 16.2-17.2, 17.2, 17.2-18.2, 18.2
   bareos-vmware-plugin,  , 15.2-16.2, 16.2-17.2, 17.2, 17.2-18.2, 18.2
   bareos-vmware-plugin-compat,  ,  ,  ,  , 18.2, 18.2
   bareos-vmware-vix-disklib,  , 15.2-16.2, 16.2-17.2, 17.2, 17.2-18.2,  
   bareos-webui,  , 15.2-17.2, 15.2-17.2, 17.2, 17.2-18.2, 18.2
   libdroplet,  ,  , 17.2, 17.2, 17.2-18.2, 18.2
   libfastlz, 14.2, 14.2-17.2, 14.2-17.2, 17.2, 17.2-18.2, 18.2
   libjansson4,  , 15.2-17.2, 15.2-17.2, 17.2, 17.2-18.2, 18.2
   libjansson4-32bit,  , 15.2-17.2,  ,  ,  ,  
   libjansson4-x86,  , 15.2-17.2,  ,  ,  ,  
   python-bareos,  , 17.2, 17.2, 17.2, 17.2-18.2, 18.2
   python-py,  , 15.2-16.2,  ,  ,  ,  
   python-pyvmomi,  , 15.2-17.2, 16.2-17.2, 17.2, 17.2,  
   python-requests,  , 15.2-16.2,  ,  ,  ,  
   python-six,  , 15.2-16.2,  ,  ,  ,  

