.. csv-table::
   :header: "configuration directive name", "type of data", "default value", "remark"

   :config:option:`dir/storage/Address`\                       , "**= STRING** ", "", "**required** "
   :config:option:`dir/storage/AllowCompression`\              , "= BOOLEAN", "yes", ""
   :config:option:`dir/storage/AuthType`\                      , "= AUTH_TYPE", "None", ""
   :config:option:`dir/storage/AutoChanger`\                   , "= BOOLEAN", "no", ""
   :config:option:`dir/storage/CacheStatusInterval`\           , "= TIME", "30", ""
   :config:option:`dir/storage/CollectStatistics`\             , "= BOOLEAN", "no", ""
   :config:option:`dir/storage/Description`\                   , "= STRING", "", ""
   :config:option:`dir/storage/Device`\                        , "**= DEVICE** ", "", "**required** "
   :config:option:`dir/storage/Enabled`\                       , "= BOOLEAN", "yes", ""
   :config:option:`dir/storage/HeartbeatInterval`\             , "= TIME", "0", ""
   :config:option:`dir/storage/LanAddress`\                    , "= STRING", "", ""
   :config:option:`dir/storage/MaximumBandwidthPerJob`\        , "= SPEED", "", ""
   :config:option:`dir/storage/MaximumConcurrentJobs`\         , "= PINT32", "1", ""
   :config:option:`dir/storage/MaximumConcurrentReadJobs`\     , "= PINT32", "0", ""
   :config:option:`dir/storage/MediaType`\                     , "**= STRNAME** ", "", "**required** "
   :config:option:`dir/storage/Name`\                          , "**= NAME** ", "", "**required** "
   :config:option:`dir/storage/NdmpChangerDevice`\             , "= STRNAME", "", ""
   :config:option:`dir/storage/PairedStorage`\                 , "= RES", "", ""
   :config:option:`dir/storage/Password`\                      , "**= AUTOPASSWORD** ", "", "**required** "
   :config:option:`dir/storage/Port`\                          , "= PINT32", "9103", ""
   :config:option:`dir/storage/Protocol`\                      , "= AUTH_PROTOCOL_TYPE", "Native", ""
   :config:option:`dir/storage/SdAddress`\                     , "*= STRING* ", "", "*alias* "
   :config:option:`dir/storage/SdPassword`\                    , "*= AUTOPASSWORD* ", "", "*alias* "
   :config:option:`dir/storage/SdPort`\                        , "*= PINT32* ", "*9103* ", "*alias* "
   :config:option:`dir/storage/SddPort`\                       , "*= PINT32* ", "", "*deprecated* "
   :config:option:`dir/storage/TlsAllowedCn`\                  , "= STRING_LIST", "", ""
   :config:option:`dir/storage/TlsAuthenticate`\               , "= BOOLEAN", "no", ""
   :config:option:`dir/storage/TlsCaCertificateDir`\           , "= DIRECTORY", "", ""
   :config:option:`dir/storage/TlsCaCertificateFile`\          , "= DIRECTORY", "", ""
   :config:option:`dir/storage/TlsCertificate`\                , "= DIRECTORY", "", ""
   :config:option:`dir/storage/TlsCertificateRevocationList`\  , "= DIRECTORY", "", ""
   :config:option:`dir/storage/TlsCipherList`\                 , "= DIRECTORY", "", ""
   :config:option:`dir/storage/TlsDhFile`\                     , "= DIRECTORY", "", ""
   :config:option:`dir/storage/TlsEnable`\                     , "= BOOLEAN", "yes", ""
   :config:option:`dir/storage/TlsKey`\                        , "= DIRECTORY", "", ""
   :config:option:`dir/storage/TlsRequire`\                    , "= BOOLEAN", "no", ""
   :config:option:`dir/storage/TlsVerifyPeer`\                 , "= BOOLEAN", "no", ""
   :config:option:`dir/storage/Username`\                      , "= STRING", "", ""

