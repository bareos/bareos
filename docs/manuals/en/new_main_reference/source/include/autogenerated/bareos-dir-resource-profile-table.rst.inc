.. csv-table::
   :header: "configuration directive name", "type of data", "default value", "remark"

   :config:option:`dir/profile/CatalogACL`\                    , "= ACL", "", ""
   :config:option:`dir/profile/ClientACL`\                     , "= ACL", "", ""
   :config:option:`dir/profile/CommandACL`\                    , "= ACL", "", ""
   :config:option:`dir/profile/Description`\                   , "= STRING", "", ""
   :config:option:`dir/profile/FileSetACL`\                    , "= ACL", "", ""
   :config:option:`dir/profile/JobACL`\                        , "= ACL", "", ""
   :config:option:`dir/profile/Name`\                          , "**= NAME** ", "", "**required** "
   :config:option:`dir/profile/PluginOptionsACL`\              , "= ACL", "", ""
   :config:option:`dir/profile/PoolACL`\                       , "= ACL", "", ""
   :config:option:`dir/profile/ScheduleACL`\                   , "= ACL", "", ""
   :config:option:`dir/profile/StorageACL`\                    , "= ACL", "", ""
   :config:option:`dir/profile/WhereACL`\                      , "= ACL", "", ""

