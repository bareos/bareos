.. csv-table::
   :header: "configuration directive name", "type of data", "default value", "remark"

   :config:option:`dir/job/Accurate`\                          , "= BOOLEAN", "no", ""
   :config:option:`dir/job/AddPrefix`\                         , "= STRING", "", ""
   :config:option:`dir/job/AddSuffix`\                         , "= STRING", "", ""
   :config:option:`dir/job/AllowDuplicateJobs`\                , "= BOOLEAN", "yes", ""
   :config:option:`dir/job/AllowHigherDuplicates`\             , "= BOOLEAN", "yes", ""
   :config:option:`dir/job/AllowMixedPriority`\                , "= BOOLEAN", "no", ""
   :config:option:`dir/job/AlwaysIncremental`\                 , "= BOOLEAN", "no", ""
   :config:option:`dir/job/AlwaysIncrementalJobRetention`\     , "= TIME", "0", ""
   :config:option:`dir/job/AlwaysIncrementalKeepNumber`\       , "= PINT32", "0", ""
   :config:option:`dir/job/AlwaysIncrementalMaxFullAge`\       , "= TIME", "", ""
   :config:option:`dir/job/BackupFormat`\                      , "= STRING", "Native", ""
   :config:option:`dir/job/Base`\                              , "= RESOURCE_LIST", "", ""
   :config:option:`dir/job/Bootstrap`\                         , "= DIRECTORY", "", ""
   :config:option:`dir/job/CancelLowerLevelDuplicates`\        , "= BOOLEAN", "no", ""
   :config:option:`dir/job/CancelQueuedDuplicates`\            , "= BOOLEAN", "no", ""
   :config:option:`dir/job/CancelRunningDuplicates`\           , "= BOOLEAN", "no", ""
   :config:option:`dir/job/Catalog`\                           , "= RES", "", ""
   :config:option:`dir/job/Client`\                            , "= RES", "", ""
   :config:option:`dir/job/ClientRunAfterJob`\                 , "= RUNSCRIPT_SHORT", "", ""
   :config:option:`dir/job/ClientRunBeforeJob`\                , "= RUNSCRIPT_SHORT", "", ""
   :config:option:`dir/job/Description`\                       , "= STRING", "", ""
   :config:option:`dir/job/DifferentialBackupPool`\            , "= RES", "", ""
   :config:option:`dir/job/DifferentialMaxRuntime`\            , "= TIME", "", ""
   :config:option:`dir/job/DifferentialMaxWaitTime`\           , "*= TIME* ", "", "*deprecated* "
   :config:option:`dir/job/DirPluginOptions`\                  , "= STRING_LIST", "", ""
   :config:option:`dir/job/Enabled`\                           , "= BOOLEAN", "yes", ""
   :config:option:`dir/job/FdPluginOptions`\                   , "= STRING_LIST", "", ""
   :config:option:`dir/job/FileHistorySize`\                   , "= SIZE64", "10000000", ""
   :config:option:`dir/job/FileSet`\                           , "= RES", "", ""
   :config:option:`dir/job/FullBackupPool`\                    , "= RES", "", ""
   :config:option:`dir/job/FullMaxRuntime`\                    , "= TIME", "", ""
   :config:option:`dir/job/FullMaxWaitTime`\                   , "*= TIME* ", "", "*deprecated* "
   :config:option:`dir/job/IncrementalBackupPool`\             , "= RES", "", ""
   :config:option:`dir/job/IncrementalMaxRuntime`\             , "= TIME", "", ""
   :config:option:`dir/job/IncrementalMaxWaitTime`\            , "*= TIME* ", "", "*deprecated* "
   :config:option:`dir/job/JobDefs`\                           , "= RES", "", ""
   :config:option:`dir/job/JobToVerify`\                       , "= RES", "", ""
   :config:option:`dir/job/Level`\                             , "= BACKUP_LEVEL", "", ""
   :config:option:`dir/job/MaxConcurrentCopies`\               , "= PINT32", "100", ""
   :config:option:`dir/job/MaxDiffInterval`\                   , "= TIME", "", ""
   :config:option:`dir/job/MaxFullConsolidations`\             , "= PINT32", "0", ""
   :config:option:`dir/job/MaxFullInterval`\                   , "= TIME", "", ""
   :config:option:`dir/job/MaxRunSchedTime`\                   , "= TIME", "", ""
   :config:option:`dir/job/MaxRunTime`\                        , "= TIME", "", ""
   :config:option:`dir/job/MaxStartDelay`\                     , "= TIME", "", ""
   :config:option:`dir/job/MaxVirtualFullInterval`\            , "= TIME", "", ""
   :config:option:`dir/job/MaxWaitTime`\                       , "= TIME", "", ""
   :config:option:`dir/job/MaximumBandwidth`\                  , "= SPEED", "", ""
   :config:option:`dir/job/MaximumConcurrentJobs`\             , "= PINT32", "1", ""
   :config:option:`dir/job/Messages`\                          , "**= RES** ", "", "**required** "
   :config:option:`dir/job/Name`\                              , "**= NAME** ", "", "**required** "
   :config:option:`dir/job/NextPool`\                          , "= RES", "", ""
   :config:option:`dir/job/PluginOptions`\                     , "*= STRING_LIST* ", "", "*alias, deprecated* "
   :config:option:`dir/job/Pool`\                              , "**= RES** ", "", "**required** "
   :config:option:`dir/job/PreferMountedVolumes`\              , "= BOOLEAN", "yes", ""
   :config:option:`dir/job/PrefixLinks`\                       , "= BOOLEAN", "no", ""
   :config:option:`dir/job/Priority`\                          , "= PINT32", "10", ""
   :config:option:`dir/job/Protocol`\                          , "= PROTOCOL_TYPE", "Native", ""
   :config:option:`dir/job/PruneFiles`\                        , "= BOOLEAN", "no", ""
   :config:option:`dir/job/PruneJobs`\                         , "= BOOLEAN", "no", ""
   :config:option:`dir/job/PruneVolumes`\                      , "= BOOLEAN", "no", ""
   :config:option:`dir/job/PurgeMigrationJob`\                 , "= BOOLEAN", "no", ""
   :config:option:`dir/job/RegexWhere`\                        , "= STRING", "", ""
   :config:option:`dir/job/Replace`\                           , "= REPLACE_OPTION", "Always", ""
   :config:option:`dir/job/RerunFailedLevels`\                 , "= BOOLEAN", "no", ""
   :config:option:`dir/job/RescheduleInterval`\                , "= TIME", "1800", ""
   :config:option:`dir/job/RescheduleOnError`\                 , "= BOOLEAN", "no", ""
   :config:option:`dir/job/RescheduleTimes`\                   , "= PINT32", "5", ""
   :config:option:`dir/job/Run`\                               , "= STRING_LIST", "", ""
   :config:option:`dir/job/RunAfterFailedJob`\                 , "= RUNSCRIPT_SHORT", "", ""
   :config:option:`dir/job/RunAfterJob`\                       , "= RUNSCRIPT_SHORT", "", ""
   :config:option:`dir/job/RunBeforeJob`\                      , "= RUNSCRIPT_SHORT", "", ""
   :config:option:`dir/job/RunScript`\                         , "\{ RUNSCRIPT \}", "", ""
   :config:option:`dir/job/SaveFileHistory`\                   , "= BOOLEAN", "yes", ""
   :config:option:`dir/job/Schedule`\                          , "= RES", "", ""
   :config:option:`dir/job/SdPluginOptions`\                   , "= STRING_LIST", "", ""
   :config:option:`dir/job/SelectionPattern`\                  , "= STRING", "", ""
   :config:option:`dir/job/SelectionType`\                     , "= MIGRATION_TYPE", "", ""
   :config:option:`dir/job/SpoolAttributes`\                   , "= BOOLEAN", "no", ""
   :config:option:`dir/job/SpoolData`\                         , "= BOOLEAN", "no", ""
   :config:option:`dir/job/SpoolSize`\                         , "= SIZE64", "", ""
   :config:option:`dir/job/Storage`\                           , "= RESOURCE_LIST", "", ""
   :config:option:`dir/job/StripPrefix`\                       , "= STRING", "", ""
   :config:option:`dir/job/Type`\                              , "**= JOB_TYPE** ", "", "**required** "
   :config:option:`dir/job/VerifyJob`\                         , "*= RES* ", "", "*alias* "
   :config:option:`dir/job/VirtualFullBackupPool`\             , "= RES", "", ""
   :config:option:`dir/job/Where`\                             , "= DIRECTORY", "", ""
   :config:option:`dir/job/WriteBootstrap`\                    , "= DIRECTORY", "", ""
   :config:option:`dir/job/WritePartAfterJob`\                 , "*= BOOLEAN* ", "", "*deprecated* "
   :config:option:`dir/job/WriteVerifyList`\                   , "= DIRECTORY", "", ""

