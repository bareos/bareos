.. index::
   single: Platform; Ubuntu; 10.04
   single: Platform; Ubuntu; 12.04
   single: Platform; Ubuntu; 14.04
   single: Platform; Ubuntu; 16.04
   single: Platform; Ubuntu; 18.04
   single: Platform; Ubuntu; 8.04

.. csv-table::
   :header: "", "Ubuntu 10.04", "Ubuntu 12.04", "Ubuntu 14.04", "Ubuntu 16.04", "Ubuntu 18.04", "Ubuntu 8.04"

   bareos, 12.4-15.2, 12.4-17.2, 13.2-18.2, 15.2-18.2, 18.2, 13.2-14.2
   bareos-bat, 12.4-15.2, 12.4-16.2, 13.2-16.2, 15.2-16.2,  ,  
   bareos-bconsole, 12.4-15.2, 12.4-17.2, 13.2-18.2, 15.2-18.2, 18.2, 13.2-14.2
   bareos-client, 12.4-15.2, 12.4-17.2, 13.2-18.2, 15.2-18.2, 18.2, 13.2-14.2
   bareos-common, 12.4-15.2, 12.4-17.2, 13.2-18.2, 15.2-18.2, 18.2, 13.2-14.2
   bareos-database-common, 12.4-15.2, 12.4-17.2, 13.2-18.2, 15.2-18.2, 18.2, 13.2-14.2
   bareos-database-mysql, 12.4-15.2, 12.4-17.2, 13.2-18.2, 15.2-18.2, 18.2, 13.2-14.2
   bareos-database-postgresql, 12.4-15.2, 12.4-17.2, 13.2-18.2, 15.2-18.2, 18.2, 13.2-14.2
   bareos-database-sqlite3, 12.4-15.2, 12.4-17.2, 13.2-18.2, 15.2-18.2, 18.2, 13.2-14.2
   bareos-database-tools, 12.4-15.2, 12.4-17.2, 13.2-18.2, 15.2-18.2, 18.2, 13.2-14.2
   bareos-director, 12.4-15.2, 12.4-17.2, 13.2-18.2, 15.2-18.2, 18.2, 13.2-14.2
   bareos-director-python-plugin, 14.2-15.2, 14.2-17.2, 14.2-18.2, 15.2-18.2, 18.2,  
   bareos-filedaemon, 12.4-15.2, 12.4-17.2, 13.2-18.2, 15.2-18.2, 18.2, 13.2-14.2
   bareos-filedaemon-ceph-plugin,  ,  , 15.2-16.2, 15.2-18.2, 18.2,  
   bareos-filedaemon-glusterfs-plugin,  ,  ,  , 15.2-17.2,  ,  
   bareos-filedaemon-ldap-python-plugin, 15.2, 15.2-17.2, 15.2-18.2, 15.2-18.2, 18.2,  
   bareos-filedaemon-python-plugin, 14.2-15.2, 14.2-17.2, 14.2-18.2, 15.2-18.2, 18.2,  
   bareos-regress-config,  , 17.2, 17.2-18.2, 17.2-18.2, 18.2,  
   bareos-storage, 12.4-15.2, 12.4-17.2, 13.2-18.2, 15.2-18.2, 18.2, 13.2-14.2
   bareos-storage-ceph,  ,  , 15.2-16.2, 15.2-18.2, 18.2,  
   bareos-storage-fifo, 14.2-15.2, 14.2-17.2, 14.2-18.2, 15.2-18.2, 18.2, 14.2
   bareos-storage-glusterfs,  ,  ,  , 15.2-17.2,  ,  
   bareos-storage-python-plugin, 14.2-15.2, 14.2-17.2, 14.2-18.2, 15.2-18.2, 18.2,  
   bareos-storage-tape, 12.4-15.2, 12.4-17.2, 13.2-18.2, 15.2-18.2, 18.2, 13.2-14.2
   bareos-tools, 12.4-15.2, 12.4-17.2, 13.2-18.2, 15.2-18.2, 18.2, 13.2-14.2
   bareos-traymonitor, 12.4-15.2, 12.4-17.2, 13.2-18.2, 15.2-18.2, 18.2,  
   bareos-vadp-dumper,  ,  ,  , 17.2-18.2, 18.2,  
   bareos-vmware-plugin,  ,  ,  , 17.2-18.2, 18.2,  
   bareos-vmware-plugin-compat,  ,  ,  , 18.2, 18.2,  
   bareos-vmware-vix-disklib,  ,  ,  , 17.2-18.2, 18.2,  
   bareos-webui, 15.2, 15.2-17.2, 15.2-18.2, 15.2-18.2, 18.2,  
   libfastlz, 12.4-15.2, 12.4-17.2, 12.4-18.2, 15.2-18.2, 18.2, 13.2-14.2
   libjansson4, 15.2,  ,  ,  ,  ,  
   python-bareos,  ,  , 17.2-18.2, 17.2-18.2, 18.2,  

