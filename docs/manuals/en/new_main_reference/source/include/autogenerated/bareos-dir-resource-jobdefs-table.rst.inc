.. csv-table::
   :header: "configuration directive name", "type of data", "default value", "remark"

   :config:option:`dir/jobdefs/Accurate`\                      , "= BOOLEAN", "no", ""
   :config:option:`dir/jobdefs/AddPrefix`\                     , "= STRING", "", ""
   :config:option:`dir/jobdefs/AddSuffix`\                     , "= STRING", "", ""
   :config:option:`dir/jobdefs/AllowDuplicateJobs`\            , "= BOOLEAN", "yes", ""
   :config:option:`dir/jobdefs/AllowHigherDuplicates`\         , "= BOOLEAN", "yes", ""
   :config:option:`dir/jobdefs/AllowMixedPriority`\            , "= BOOLEAN", "no", ""
   :config:option:`dir/jobdefs/AlwaysIncremental`\             , "= BOOLEAN", "no", ""
   :config:option:`dir/jobdefs/AlwaysIncrementalJobRetention`\ , "= TIME", "0", ""
   :config:option:`dir/jobdefs/AlwaysIncrementalKeepNumber`\   , "= PINT32", "0", ""
   :config:option:`dir/jobdefs/AlwaysIncrementalMaxFullAge`\   , "= TIME", "", ""
   :config:option:`dir/jobdefs/BackupFormat`\                  , "= STRING", "Native", ""
   :config:option:`dir/jobdefs/Base`\                          , "= RESOURCE_LIST", "", ""
   :config:option:`dir/jobdefs/Bootstrap`\                     , "= DIRECTORY", "", ""
   :config:option:`dir/jobdefs/CancelLowerLevelDuplicates`\    , "= BOOLEAN", "no", ""
   :config:option:`dir/jobdefs/CancelQueuedDuplicates`\        , "= BOOLEAN", "no", ""
   :config:option:`dir/jobdefs/CancelRunningDuplicates`\       , "= BOOLEAN", "no", ""
   :config:option:`dir/jobdefs/Catalog`\                       , "= RES", "", ""
   :config:option:`dir/jobdefs/Client`\                        , "= RES", "", ""
   :config:option:`dir/jobdefs/ClientRunAfterJob`\             , "= RUNSCRIPT_SHORT", "", ""
   :config:option:`dir/jobdefs/ClientRunBeforeJob`\            , "= RUNSCRIPT_SHORT", "", ""
   :config:option:`dir/jobdefs/Description`\                   , "= STRING", "", ""
   :config:option:`dir/jobdefs/DifferentialBackupPool`\        , "= RES", "", ""
   :config:option:`dir/jobdefs/DifferentialMaxRuntime`\        , "= TIME", "", ""
   :config:option:`dir/jobdefs/DifferentialMaxWaitTime`\       , "*= TIME* ", "", "*deprecated* "
   :config:option:`dir/jobdefs/DirPluginOptions`\              , "= STRING_LIST", "", ""
   :config:option:`dir/jobdefs/Enabled`\                       , "= BOOLEAN", "yes", ""
   :config:option:`dir/jobdefs/FdPluginOptions`\               , "= STRING_LIST", "", ""
   :config:option:`dir/jobdefs/FileHistorySize`\               , "= SIZE64", "10000000", ""
   :config:option:`dir/jobdefs/FileSet`\                       , "= RES", "", ""
   :config:option:`dir/jobdefs/FullBackupPool`\                , "= RES", "", ""
   :config:option:`dir/jobdefs/FullMaxRuntime`\                , "= TIME", "", ""
   :config:option:`dir/jobdefs/FullMaxWaitTime`\               , "*= TIME* ", "", "*deprecated* "
   :config:option:`dir/jobdefs/IncrementalBackupPool`\         , "= RES", "", ""
   :config:option:`dir/jobdefs/IncrementalMaxRuntime`\         , "= TIME", "", ""
   :config:option:`dir/jobdefs/IncrementalMaxWaitTime`\        , "*= TIME* ", "", "*deprecated* "
   :config:option:`dir/jobdefs/JobDefs`\                       , "= RES", "", ""
   :config:option:`dir/jobdefs/JobToVerify`\                   , "= RES", "", ""
   :config:option:`dir/jobdefs/Level`\                         , "= BACKUP_LEVEL", "", ""
   :config:option:`dir/jobdefs/MaxConcurrentCopies`\           , "= PINT32", "100", ""
   :config:option:`dir/jobdefs/MaxDiffInterval`\               , "= TIME", "", ""
   :config:option:`dir/jobdefs/MaxFullConsolidations`\         , "= PINT32", "0", ""
   :config:option:`dir/jobdefs/MaxFullInterval`\               , "= TIME", "", ""
   :config:option:`dir/jobdefs/MaxRunSchedTime`\               , "= TIME", "", ""
   :config:option:`dir/jobdefs/MaxRunTime`\                    , "= TIME", "", ""
   :config:option:`dir/jobdefs/MaxStartDelay`\                 , "= TIME", "", ""
   :config:option:`dir/jobdefs/MaxVirtualFullInterval`\        , "= TIME", "", ""
   :config:option:`dir/jobdefs/MaxWaitTime`\                   , "= TIME", "", ""
   :config:option:`dir/jobdefs/MaximumBandwidth`\              , "= SPEED", "", ""
   :config:option:`dir/jobdefs/MaximumConcurrentJobs`\         , "= PINT32", "1", ""
   :config:option:`dir/jobdefs/Messages`\                      , "**= RES** ", "", "**required** "
   :config:option:`dir/jobdefs/Name`\                          , "**= NAME** ", "", "**required** "
   :config:option:`dir/jobdefs/NextPool`\                      , "= RES", "", ""
   :config:option:`dir/jobdefs/PluginOptions`\                 , "*= STRING_LIST* ", "", "*alias, deprecated* "
   :config:option:`dir/jobdefs/Pool`\                          , "**= RES** ", "", "**required** "
   :config:option:`dir/jobdefs/PreferMountedVolumes`\          , "= BOOLEAN", "yes", ""
   :config:option:`dir/jobdefs/PrefixLinks`\                   , "= BOOLEAN", "no", ""
   :config:option:`dir/jobdefs/Priority`\                      , "= PINT32", "10", ""
   :config:option:`dir/jobdefs/Protocol`\                      , "= PROTOCOL_TYPE", "Native", ""
   :config:option:`dir/jobdefs/PruneFiles`\                    , "= BOOLEAN", "no", ""
   :config:option:`dir/jobdefs/PruneJobs`\                     , "= BOOLEAN", "no", ""
   :config:option:`dir/jobdefs/PruneVolumes`\                  , "= BOOLEAN", "no", ""
   :config:option:`dir/jobdefs/PurgeMigrationJob`\             , "= BOOLEAN", "no", ""
   :config:option:`dir/jobdefs/RegexWhere`\                    , "= STRING", "", ""
   :config:option:`dir/jobdefs/Replace`\                       , "= REPLACE_OPTION", "Always", ""
   :config:option:`dir/jobdefs/RerunFailedLevels`\             , "= BOOLEAN", "no", ""
   :config:option:`dir/jobdefs/RescheduleInterval`\            , "= TIME", "1800", ""
   :config:option:`dir/jobdefs/RescheduleOnError`\             , "= BOOLEAN", "no", ""
   :config:option:`dir/jobdefs/RescheduleTimes`\               , "= PINT32", "5", ""
   :config:option:`dir/jobdefs/Run`\                           , "= STRING_LIST", "", ""
   :config:option:`dir/jobdefs/RunAfterFailedJob`\             , "= RUNSCRIPT_SHORT", "", ""
   :config:option:`dir/jobdefs/RunAfterJob`\                   , "= RUNSCRIPT_SHORT", "", ""
   :config:option:`dir/jobdefs/RunBeforeJob`\                  , "= RUNSCRIPT_SHORT", "", ""
   :config:option:`dir/jobdefs/RunScript`\                     , "\{ RUNSCRIPT \}", "", ""
   :config:option:`dir/jobdefs/SaveFileHistory`\               , "= BOOLEAN", "yes", ""
   :config:option:`dir/jobdefs/Schedule`\                      , "= RES", "", ""
   :config:option:`dir/jobdefs/SdPluginOptions`\               , "= STRING_LIST", "", ""
   :config:option:`dir/jobdefs/SelectionPattern`\              , "= STRING", "", ""
   :config:option:`dir/jobdefs/SelectionType`\                 , "= MIGRATION_TYPE", "", ""
   :config:option:`dir/jobdefs/SpoolAttributes`\               , "= BOOLEAN", "no", ""
   :config:option:`dir/jobdefs/SpoolData`\                     , "= BOOLEAN", "no", ""
   :config:option:`dir/jobdefs/SpoolSize`\                     , "= SIZE64", "", ""
   :config:option:`dir/jobdefs/Storage`\                       , "= RESOURCE_LIST", "", ""
   :config:option:`dir/jobdefs/StripPrefix`\                   , "= STRING", "", ""
   :config:option:`dir/jobdefs/Type`\                          , "**= JOB_TYPE** ", "", "**required** "
   :config:option:`dir/jobdefs/VerifyJob`\                     , "*= RES* ", "", "*alias* "
   :config:option:`dir/jobdefs/VirtualFullBackupPool`\         , "= RES", "", ""
   :config:option:`dir/jobdefs/Where`\                         , "= DIRECTORY", "", ""
   :config:option:`dir/jobdefs/WriteBootstrap`\                , "= DIRECTORY", "", ""
   :config:option:`dir/jobdefs/WritePartAfterJob`\             , "*= BOOLEAN* ", "", "*deprecated* "
   :config:option:`dir/jobdefs/WriteVerifyList`\               , "= DIRECTORY", "", ""

