.. csv-table::
   :header: "configuration directive name", "type of data", "default value", "remark"

   :config:option:`dir/messages/Append`\                       , "= MESSAGES", "", ""
   :config:option:`dir/messages/Catalog`\                      , "= MESSAGES", "", ""
   :config:option:`dir/messages/Console`\                      , "= MESSAGES", "", ""
   :config:option:`dir/messages/Description`\                  , "= STRING", "", ""
   :config:option:`dir/messages/Director`\                     , "= MESSAGES", "", ""
   :config:option:`dir/messages/File`\                         , "= MESSAGES", "", ""
   :config:option:`dir/messages/Mail`\                         , "= MESSAGES", "", ""
   :config:option:`dir/messages/MailCommand`\                  , "= STRING", "", ""
   :config:option:`dir/messages/MailOnError`\                  , "= MESSAGES", "", ""
   :config:option:`dir/messages/MailOnSuccess`\                , "= MESSAGES", "", ""
   :config:option:`dir/messages/Name`\                         , "= NAME", "", ""
   :config:option:`dir/messages/Operator`\                     , "= MESSAGES", "", ""
   :config:option:`dir/messages/OperatorCommand`\              , "= STRING", "", ""
   :config:option:`dir/messages/Stderr`\                       , "= MESSAGES", "", ""
   :config:option:`dir/messages/Stdout`\                       , "= MESSAGES", "", ""
   :config:option:`dir/messages/Syslog`\                       , "= MESSAGES", "", ""
   :config:option:`dir/messages/TimestampFormat`\              , "= STRING", "", ""

