.. config:option:: sd/ndmp/AuthType

   :type: AUTH_TYPE
   :default: None

   .. include:: /config-directive-description/sd-ndmp-AuthType.rst.inc



.. config:option:: sd/ndmp/Description

   :type: STRING

   .. include:: /config-directive-description/sd-ndmp-Description.rst.inc



.. config:option:: sd/ndmp/LogLevel

   :type: PINT32
   :default: 4

   .. include:: /config-directive-description/sd-ndmp-LogLevel.rst.inc



.. config:option:: sd/ndmp/Name

   :required: True
   :type: NAME

   .. include:: /config-directive-description/sd-ndmp-Name.rst.inc



.. config:option:: sd/ndmp/Password

   :required: True
   :type: AUTOPASSWORD

   .. include:: /config-directive-description/sd-ndmp-Password.rst.inc



.. config:option:: sd/ndmp/Username

   :required: True
   :type: STRING

   .. include:: /config-directive-description/sd-ndmp-Username.rst.inc



