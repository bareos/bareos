 Bareosfd_API[Bareosfd_PyParsePluginDefinition_NUM] = (void*)PyParsePluginDefinition;
 Bareosfd_API[Bareosfd_PyGetPluginValue_NUM] = (void*)PyGetPluginValue;
 Bareosfd_API[Bareosfd_PySetPluginValue_NUM] = (void*)PySetPluginValue;
 Bareosfd_API[Bareosfd_PyHandlePluginEvent_NUM] = (void*)PyHandlePluginEvent;
 Bareosfd_API[Bareosfd_PyStartBackupFile_NUM] = (void*)PyStartBackupFile;
 Bareosfd_API[Bareosfd_PyEndBackupFile_NUM] = (void*)PyEndBackupFile;
 Bareosfd_API[Bareosfd_PyPluginIO_NUM] = (void*)PyPluginIO;
 Bareosfd_API[Bareosfd_PyStartRestoreFile_NUM] = (void*)PyStartRestoreFile;
 Bareosfd_API[Bareosfd_PyEndRestoreFile_NUM] = (void*)PyEndRestoreFile;
 Bareosfd_API[Bareosfd_PyCreateFile_NUM] = (void*)PyCreateFile;
 Bareosfd_API[Bareosfd_PySetFileAttributes_NUM] = (void*)PySetFileAttributes;
 Bareosfd_API[Bareosfd_PyCheckFile_NUM] = (void*)PyCheckFile;
 Bareosfd_API[Bareosfd_PyGetAcl_NUM] = (void*)PyGetAcl;
 Bareosfd_API[Bareosfd_PySetAcl_NUM] = (void*)PySetAcl;
 Bareosfd_API[Bareosfd_PyGetXattr_NUM] = (void*)PyGetXattr;
 Bareosfd_API[Bareosfd_PySetXattr_NUM] = (void*)PySetXattr;
 Bareosfd_API[Bareosfd_PyRestoreObjectData_NUM] = (void*)PyRestoreObjectData;
 Bareosfd_API[Bareosfd_PyHandleBackupFile_NUM] = (void*)PyHandleBackupFile;
 Bareosfd_API[Bareosfd_set_bareos_core_functions_NUM] = (void*)set_bareos_core_functions;
