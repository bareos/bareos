#define Bareosfd_newPlugin (*(Bareosfd_newPlugin_RETURN(*)Bareosfd_newPlugin_PROTO) Bareosfd_API[Bareosfd_newPlugin_NUM])

#define Bareosfd_freePlugin (*(Bareosfd_freePlugin_RETURN(*)Bareosfd_freePlugin_PROTO) Bareosfd_API[Bareosfd_freePlugin_NUM])

#define Bareosfd_getPluginValue (*(Bareosfd_getPluginValue_RETURN(*)Bareosfd_getPluginValue_PROTO) Bareosfd_API[Bareosfd_getPluginValue_NUM])

#define Bareosfd_setPluginValue (*(Bareosfd_setPluginValue_RETURN(*)Bareosfd_setPluginValue_PROTO) Bareosfd_API[Bareosfd_setPluginValue_NUM])

#define Bareosfd_handlePluginEvent (*(Bareosfd_handlePluginEvent_RETURN(*)Bareosfd_handlePluginEvent_PROTO) Bareosfd_API[Bareosfd_handlePluginEvent_NUM])

#define Bareosfd_startBackupFile (*(Bareosfd_startBackupFile_RETURN(*)Bareosfd_startBackupFile_PROTO) Bareosfd_API[Bareosfd_startBackupFile_NUM])

#define Bareosfd_endBackupFile (*(Bareosfd_endBackupFile_RETURN(*)Bareosfd_endBackupFile_PROTO) Bareosfd_API[Bareosfd_endBackupFile_NUM])

#define Bareosfd_pluginIO (*(Bareosfd_pluginIO_RETURN(*)Bareosfd_pluginIO_PROTO) Bareosfd_API[Bareosfd_pluginIO_NUM])

#define Bareosfd_startRestoreFile (*(Bareosfd_startRestoreFile_RETURN(*)Bareosfd_startRestoreFile_PROTO) Bareosfd_API[Bareosfd_startRestoreFile_NUM])

#define Bareosfd_endRestoreFile (*(Bareosfd_endRestoreFile_RETURN(*)Bareosfd_endRestoreFile_PROTO) Bareosfd_API[Bareosfd_endRestoreFile_NUM])

#define Bareosfd_createFile (*(Bareosfd_createFile_RETURN(*)Bareosfd_createFile_PROTO) Bareosfd_API[Bareosfd_createFile_NUM])

#define Bareosfd_setFileAttributes (*(Bareosfd_setFileAttributes_RETURN(*)Bareosfd_setFileAttributes_PROTO) Bareosfd_API[Bareosfd_setFileAttributes_NUM])

#define Bareosfd_checkFile (*(Bareosfd_checkFile_RETURN(*)Bareosfd_checkFile_PROTO) Bareosfd_API[Bareosfd_checkFile_NUM])

#define Bareosfd_getAcl (*(Bareosfd_getAcl_RETURN(*)Bareosfd_getAcl_PROTO) Bareosfd_API[Bareosfd_getAcl_NUM])

#define Bareosfd_setAcl (*(Bareosfd_setAcl_RETURN(*)Bareosfd_setAcl_PROTO) Bareosfd_API[Bareosfd_setAcl_NUM])

#define Bareosfd_getXattr (*(Bareosfd_getXattr_RETURN(*)Bareosfd_getXattr_PROTO) Bareosfd_API[Bareosfd_getXattr_NUM])

#define Bareosfd_setXattr (*(Bareosfd_setXattr_RETURN(*)Bareosfd_setXattr_PROTO) Bareosfd_API[Bareosfd_setXattr_NUM])

#define Bareosfd_parse_plugin_definition (*(Bareosfd_parse_plugin_definition_RETURN(*)Bareosfd_parse_plugin_definition_PROTO) Bareosfd_API[Bareosfd_parse_plugin_definition_NUM])

#define Bareosfd_PyLoadModule (*(Bareosfd_PyLoadModule_RETURN(*)Bareosfd_PyLoadModule_PROTO) Bareosfd_API[Bareosfd_PyLoadModule_NUM])

#define Bareosfd_PyParsePluginDefinition (*(Bareosfd_PyParsePluginDefinition_RETURN(*)Bareosfd_PyParsePluginDefinition_PROTO) Bareosfd_API[Bareosfd_PyParsePluginDefinition_NUM])

#define Bareosfd_PyGetPluginValue (*(Bareosfd_PyGetPluginValue_RETURN(*)Bareosfd_PyGetPluginValue_PROTO) Bareosfd_API[Bareosfd_PyGetPluginValue_NUM])

#define Bareosfd_PySetPluginValue (*(Bareosfd_PySetPluginValue_RETURN(*)Bareosfd_PySetPluginValue_PROTO) Bareosfd_API[Bareosfd_PySetPluginValue_NUM])

#define Bareosfd_PyHandlePluginEvent (*(Bareosfd_PyHandlePluginEvent_RETURN(*)Bareosfd_PyHandlePluginEvent_PROTO) Bareosfd_API[Bareosfd_PyHandlePluginEvent_NUM])

#define Bareosfd_PyStartBackupFile (*(Bareosfd_PyStartBackupFile_RETURN(*)Bareosfd_PyStartBackupFile_PROTO) Bareosfd_API[Bareosfd_PyStartBackupFile_NUM])

#define Bareosfd_PyEndBackupFile (*(Bareosfd_PyEndBackupFile_RETURN(*)Bareosfd_PyEndBackupFile_PROTO) Bareosfd_API[Bareosfd_PyEndBackupFile_NUM])

#define Bareosfd_PyPluginIO (*(Bareosfd_PyPluginIO_RETURN(*)Bareosfd_PyPluginIO_PROTO) Bareosfd_API[Bareosfd_PyPluginIO_NUM])

#define Bareosfd_PyStartRestoreFile (*(Bareosfd_PyStartRestoreFile_RETURN(*)Bareosfd_PyStartRestoreFile_PROTO) Bareosfd_API[Bareosfd_PyStartRestoreFile_NUM])

#define Bareosfd_PyEndRestoreFile (*(Bareosfd_PyEndRestoreFile_RETURN(*)Bareosfd_PyEndRestoreFile_PROTO) Bareosfd_API[Bareosfd_PyEndRestoreFile_NUM])

#define Bareosfd_PyCreateFile (*(Bareosfd_PyCreateFile_RETURN(*)Bareosfd_PyCreateFile_PROTO) Bareosfd_API[Bareosfd_PyCreateFile_NUM])

#define Bareosfd_PySetFileAttributes (*(Bareosfd_PySetFileAttributes_RETURN(*)Bareosfd_PySetFileAttributes_PROTO) Bareosfd_API[Bareosfd_PySetFileAttributes_NUM])

#define Bareosfd_PyCheckFile (*(Bareosfd_PyCheckFile_RETURN(*)Bareosfd_PyCheckFile_PROTO) Bareosfd_API[Bareosfd_PyCheckFile_NUM])

#define Bareosfd_PyGetAcl (*(Bareosfd_PyGetAcl_RETURN(*)Bareosfd_PyGetAcl_PROTO) Bareosfd_API[Bareosfd_PyGetAcl_NUM])

#define Bareosfd_PySetAcl (*(Bareosfd_PySetAcl_RETURN(*)Bareosfd_PySetAcl_PROTO) Bareosfd_API[Bareosfd_PySetAcl_NUM])

#define Bareosfd_PyGetXattr (*(Bareosfd_PyGetXattr_RETURN(*)Bareosfd_PyGetXattr_PROTO) Bareosfd_API[Bareosfd_PyGetXattr_NUM])

#define Bareosfd_PySetXattr (*(Bareosfd_PySetXattr_RETURN(*)Bareosfd_PySetXattr_PROTO) Bareosfd_API[Bareosfd_PySetXattr_NUM])

#define Bareosfd_PyRestoreObjectData (*(Bareosfd_PyRestoreObjectData_RETURN(*)Bareosfd_PyRestoreObjectData_PROTO) Bareosfd_API[Bareosfd_PyRestoreObjectData_NUM])

#define Bareosfd_PyHandleBackupFile (*(Bareosfd_PyHandleBackupFile_RETURN(*)Bareosfd_PyHandleBackupFile_PROTO) Bareosfd_API[Bareosfd_PyHandleBackupFile_NUM])

#define Bareosfd_set_bareos_core_functions (*(Bareosfd_set_bareos_core_functions_RETURN(*)Bareosfd_set_bareos_core_functions_PROTO) Bareosfd_API[Bareosfd_set_bareos_core_functions_NUM])

