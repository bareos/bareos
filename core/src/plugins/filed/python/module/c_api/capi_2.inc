#define Bareosfd_PyParsePluginDefinition (*(Bareosfd_PyParsePluginDefinition_RETURN(*)Bareosfd_PyParsePluginDefinition_PROTO) Bareosfd_API[Bareosfd_PyParsePluginDefinition_NUM])

#define Bareosfd_PyGetPluginValue (*(Bareosfd_PyGetPluginValue_RETURN(*)Bareosfd_PyGetPluginValue_PROTO) Bareosfd_API[Bareosfd_PyGetPluginValue_NUM])

#define Bareosfd_PySetPluginValue (*(Bareosfd_PySetPluginValue_RETURN(*)Bareosfd_PySetPluginValue_PROTO) Bareosfd_API[Bareosfd_PySetPluginValue_NUM])

#define Bareosfd_PyHandlePluginEvent (*(Bareosfd_PyHandlePluginEvent_RETURN(*)Bareosfd_PyHandlePluginEvent_PROTO) Bareosfd_API[Bareosfd_PyHandlePluginEvent_NUM])

#define Bareosfd_PyStartBackupFile (*(Bareosfd_PyStartBackupFile_RETURN(*)Bareosfd_PyStartBackupFile_PROTO) Bareosfd_API[Bareosfd_PyStartBackupFile_NUM])

#define Bareosfd_PyEndBackupFile (*(Bareosfd_PyEndBackupFile_RETURN(*)Bareosfd_PyEndBackupFile_PROTO) Bareosfd_API[Bareosfd_PyEndBackupFile_NUM])

#define Bareosfd_PyPluginIO (*(Bareosfd_PyPluginIO_RETURN(*)Bareosfd_PyPluginIO_PROTO) Bareosfd_API[Bareosfd_PyPluginIO_NUM])

#define Bareosfd_PyStartRestoreFile (*(Bareosfd_PyStartRestoreFile_RETURN(*)Bareosfd_PyStartRestoreFile_PROTO) Bareosfd_API[Bareosfd_PyStartRestoreFile_NUM])

#define Bareosfd_PyEndRestoreFile (*(Bareosfd_PyEndRestoreFile_RETURN(*)Bareosfd_PyEndRestoreFile_PROTO) Bareosfd_API[Bareosfd_PyEndRestoreFile_NUM])

#define Bareosfd_PyCreateFile (*(Bareosfd_PyCreateFile_RETURN(*)Bareosfd_PyCreateFile_PROTO) Bareosfd_API[Bareosfd_PyCreateFile_NUM])

#define Bareosfd_PySetFileAttributes (*(Bareosfd_PySetFileAttributes_RETURN(*)Bareosfd_PySetFileAttributes_PROTO) Bareosfd_API[Bareosfd_PySetFileAttributes_NUM])

#define Bareosfd_PyCheckFile (*(Bareosfd_PyCheckFile_RETURN(*)Bareosfd_PyCheckFile_PROTO) Bareosfd_API[Bareosfd_PyCheckFile_NUM])

#define Bareosfd_PyGetAcl (*(Bareosfd_PyGetAcl_RETURN(*)Bareosfd_PyGetAcl_PROTO) Bareosfd_API[Bareosfd_PyGetAcl_NUM])

#define Bareosfd_PySetAcl (*(Bareosfd_PySetAcl_RETURN(*)Bareosfd_PySetAcl_PROTO) Bareosfd_API[Bareosfd_PySetAcl_NUM])

#define Bareosfd_PyGetXattr (*(Bareosfd_PyGetXattr_RETURN(*)Bareosfd_PyGetXattr_PROTO) Bareosfd_API[Bareosfd_PyGetXattr_NUM])

#define Bareosfd_PySetXattr (*(Bareosfd_PySetXattr_RETURN(*)Bareosfd_PySetXattr_PROTO) Bareosfd_API[Bareosfd_PySetXattr_NUM])

#define Bareosfd_PyRestoreObjectData (*(Bareosfd_PyRestoreObjectData_RETURN(*)Bareosfd_PyRestoreObjectData_PROTO) Bareosfd_API[Bareosfd_PyRestoreObjectData_NUM])

#define Bareosfd_PyHandleBackupFile (*(Bareosfd_PyHandleBackupFile_RETURN(*)Bareosfd_PyHandleBackupFile_PROTO) Bareosfd_API[Bareosfd_PyHandleBackupFile_NUM])

#define Bareosfd_set_bareos_core_functions (*(Bareosfd_set_bareos_core_functions_RETURN(*)Bareosfd_set_bareos_core_functions_PROTO) Bareosfd_API[Bareosfd_set_bareos_core_functions_NUM])

#define Bareosfd_set_plugin_context (*(Bareosfd_set_plugin_context_RETURN(*)Bareosfd_set_plugin_context_PROTO) Bareosfd_API[Bareosfd_set_plugin_context_NUM])

