#define Bareosdir_PyParsePluginDefinition (*(Bareosdir_PyParsePluginDefinition_RETURN(*)Bareosdir_PyParsePluginDefinition_PROTO) Bareosdir_API[Bareosdir_PyParsePluginDefinition_NUM])

#define Bareosdir_PyGetPluginValue (*(Bareosdir_PyGetPluginValue_RETURN(*)Bareosdir_PyGetPluginValue_PROTO) Bareosdir_API[Bareosdir_PyGetPluginValue_NUM])

#define Bareosdir_PySetPluginValue (*(Bareosdir_PySetPluginValue_RETURN(*)Bareosdir_PySetPluginValue_PROTO) Bareosdir_API[Bareosdir_PySetPluginValue_NUM])

#define Bareosdir_PyHandlePluginEvent (*(Bareosdir_PyHandlePluginEvent_RETURN(*)Bareosdir_PyHandlePluginEvent_PROTO) Bareosdir_API[Bareosdir_PyHandlePluginEvent_NUM])

#define Bareosdir_set_bareos_core_functions (*(Bareosdir_set_bareos_core_functions_RETURN(*)Bareosdir_set_bareos_core_functions_PROTO) Bareosdir_API[Bareosdir_set_bareos_core_functions_NUM])

#define Bareosdir_set_plugin_context (*(Bareosdir_set_plugin_context_RETURN(*)Bareosdir_set_plugin_context_PROTO) Bareosdir_API[Bareosdir_set_plugin_context_NUM])

