#define Bareossd_PyParsePluginDefinition (*(Bareossd_PyParsePluginDefinition_RETURN(*)Bareossd_PyParsePluginDefinition_PROTO) Bareossd_API[Bareossd_PyParsePluginDefinition_NUM])

#define Bareossd_PyGetPluginValue (*(Bareossd_PyGetPluginValue_RETURN(*)Bareossd_PyGetPluginValue_PROTO) Bareossd_API[Bareossd_PyGetPluginValue_NUM])

#define Bareossd_PySetPluginValue (*(Bareossd_PySetPluginValue_RETURN(*)Bareossd_PySetPluginValue_PROTO) Bareossd_API[Bareossd_PySetPluginValue_NUM])

#define Bareossd_PyHandlePluginEvent (*(Bareossd_PyHandlePluginEvent_RETURN(*)Bareossd_PyHandlePluginEvent_PROTO) Bareossd_API[Bareossd_PyHandlePluginEvent_NUM])

#define Bareossd_set_bareos_core_functions (*(Bareossd_set_bareos_core_functions_RETURN(*)Bareossd_set_bareos_core_functions_PROTO) Bareossd_API[Bareossd_set_bareos_core_functions_NUM])

#define Bareossd_set_plugin_context (*(Bareossd_set_plugin_context_RETURN(*)Bareossd_set_plugin_context_PROTO) Bareossd_API[Bareossd_set_plugin_context_NUM])

