/* autogenerated file by ../../../../scripts/create_api_includes.sh */
/* bareos-check-sources:disable-copyright-check */

/* C API functions */

/* static bRC PyParsePluginDefinition(PluginContext* plugin_ctx, void* value); */
#define Bareossd_PyParsePluginDefinition_NUM 0
#define Bareossd_PyParsePluginDefinition_RETURN bRC
#define Bareossd_PyParsePluginDefinition_PROTO (PluginContext* plugin_ctx, const void* value)

/* static bRC PyGetPluginValue(PluginContext* plugin_ctx, pVariable var, void* value); */
#define Bareossd_PyGetPluginValue_NUM 1
#define Bareossd_PyGetPluginValue_RETURN bRC
#define Bareossd_PyGetPluginValue_PROTO (PluginContext* plugin_ctx, pVariable var, void* value)

/* static bRC PySetPluginValue(PluginContext* plugin_ctx, pVariable var, void* value); */
#define Bareossd_PySetPluginValue_NUM 2
#define Bareossd_PySetPluginValue_RETURN bRC
#define Bareossd_PySetPluginValue_PROTO (PluginContext* plugin_ctx, pVariable var, void* value)

/* static bRC PyHandlePluginEvent(PluginContext* plugin_ctx, bSdEvent* event, void* value); */
#define Bareossd_PyHandlePluginEvent_NUM 3
#define Bareossd_PyHandlePluginEvent_RETURN bRC
#define Bareossd_PyHandlePluginEvent_PROTO (PluginContext* plugin_ctx, bSdEvent* event, void* value)

/* static bRC set_bareos_core_functions( CoreFunctions* new_bareos_core_functions); */
#define Bareossd_set_bareos_core_functions_NUM 4
#define Bareossd_set_bareos_core_functions_RETURN bRC
#define Bareossd_set_bareos_core_functions_PROTO ( CoreFunctions* new_bareos_core_functions)

/* static bRC set_plugin_context(PluginContext* new_plugin_context); */
#define Bareossd_set_plugin_context_NUM 5
#define Bareossd_set_plugin_context_RETURN bRC
#define Bareossd_set_plugin_context_PROTO (PluginContext* new_plugin_context)

/*Total Number of C API function pointers */
#define Bareossd_API_pointers 6
