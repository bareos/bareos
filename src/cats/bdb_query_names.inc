/* autogenerated file by create_queryfiles.sh */

const char *B_DB::query_names[] = {
"get_restore_objects",
"cleanup_created_job",
"cleanup_running_job",
"fill_jobhisto",
"list_pool",
"list_jobs",
"list_jobs_long",
"list_jobs_count",
"list_jobs_last",
"list_jobs_long_last",
"sel_JobMedia",
"drop_deltabs",
"create_deltabs",
"create_delindex",
"uar_count_files",
"uar_list_jobs",
"uar_print_jobs",
"uar_del_temp",
"uar_del_temp1",
"uar_last_full",
"uar_last_full_no_pool",
"uar_full",
"uar_dif",
"uar_inc",
"uar_list_jobs_by_idlist",
"uar_sel_jobid_temp",
"uar_sel_all_temp1",
"uar_sel_all_temp",
"uar_sel_fileset",
"uar_sel_filesetid",
"uar_jobid_fileindex",
"uar_jobids_fileindex",
"uar_jobid_fileindex_from_table",
"select_recent_version_with_basejob",
"select_recent_version_with_basejob_and_delta",
"select_recent_version",
"create_temp_accurate_jobids",
"create_temp_basefile",
"create_temp_new_basefile",
"uap_upgrade_copies_oldest_job",
"uar_file",
"uar_create_temp",
"uar_create_temp1",
"uar_jobid_fileindex_from_dir",
"sql_media_order_most_recently_written",
"sql_get_max_connections",
"sql_bvfs_select",
"sql_bvfs_list_files",
"batch_lock_path_query",
"batch_lock_filename_query",
"batch_unlock_tables_query",
"batch_fill_path_query",
"batch_fill_filename_query",
"match_query",
"match_query2",
"insert_counter_values",
"select_counter_values",
"update_counter_values",
"get_quota_jobbytes",
"get_quota_jobbytes_nofailed",
"uar_sel_jobid_copies",
"get_jobstatus_details",
NULL
};